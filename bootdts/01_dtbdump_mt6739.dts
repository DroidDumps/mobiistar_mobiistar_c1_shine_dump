/dts-v1/;

/ {
	#address-cells = <0x02>;
	#size-cells = <0x02>;
	compatible = "mediatek,mt6739";
	interrupt-parent = <0x01>;
	model = "mt6739";

	__symbols__ {
		DPIDLE = "/cpus/idle-states/dpidle";
		MCDI_CLUSTER = "/cpus/idle-states/mcdi-cluster";
		MCDI_CPU = "/cpus/idle-states/mcdi-cpu";
		SODI = "/cpus/idle-states/sodi";
		SODI3 = "/cpus/idle-states/sodi3";
		STANDBY = "/cpus/idle-states/standby";
		SUSPEND = "/cpus/idle-states/suspend";
		accdet = "/accdet";
		als = "/als_ps@0";
		apmixed = "/apmixed@1000c000";
		apuart0 = "/apuart0@11002000";
		apuart1 = "/apuart1@11003000";
		audgpio = "/mt_soc_dl1_pcm@11220000";
		audio = "/audio@11220000";
		auxadc = "/auxadc@11001000";
		bat_gm30 = "/bat_gm30";
		charger = "/charger";
		chosen = "/chosen";
		chr_stat = "/chr_stat";
		clk26m = "/clk26m";
		clk32k = "/clk32k";
		consys = "/consys@18070000";
		cpu0 = "/cpus/cpu@0";
		cpu1 = "/cpus/cpu@001";
		cpu2 = "/cpus/cpu@002";
		cpu3 = "/cpus/cpu@003";
		cpu_dbgapb = "/cpu_dbgapb";
		disp_aal0 = "/disp_aal0@1400f000";
		disp_mutex = "/disp_mutex@14001000";
		disp_ovl0 = "/disp_ovl0@1400a000";
		dispsys = "/dispsys@14000000";
		dsi_te = "/dsi_te";
		fingerprint = "/fingerprint";
		flashlight_core = "/flashlight_core";
		flashlights_rt4505 = "/flashlights_rt4505";
		gic = "/interrupt-controller@0c000000";
		gpio = "/gpio@10005000";
		gpio_usage_mapping = "/gpio";
		gse_1 = "/gse_1";
		gyro = "/gyro";
		i2c0 = "/i2c@11007000";
		i2c1 = "/i2c@11008000";
		i2c2 = "/i2c@11009000";
		i2c3 = "/i2c@1100f000";
		i2c4 = "/i2c@11011000";
		i2c5 = "/i2c@11016000";
		imgsys_config = "/imgsys_config@15000000";
		infracfg_ao = "/infracfg_ao@10001000";
		irq_nfc = "/irq_nfc";
		irtx_pwm = "/irtx_pwm";
		kd_camera_hw1 = "/kd_camera_hw1@15008000";
		keypad = "/kp@10010000";
		leds_mt65xx = "/leds_mt65xx";
		main_flashlight_dummy = "/main_flashlight_gpio";
		main_pmic = "/pwrap@1000d000/pmic_irq";
		md1_sim1_hot_plug_eint = "/md1_sim1_hot_plug_eint";
		md1_sim2_hot_plug_eint = "/md1_sim2_hot_plug_eint";
		mdcldma = "/mdcldma@10014000";
		mdp_rdma0 = "/mdp_rdma0@14004000";
		mdp_rsz0 = "/mdp_rsz0@14005000";
		mdp_rsz1 = "/mdp_rsz1@14006000";
		mdp_tdshp0 = "/mdp_tdshp0@14009000";
		mdp_wdma0 = "/mdp_wdma0@14007000";
		mdp_wrot0 = "/mdp_wrot0@14008000";
		mm_mutex = "/mm_mutex@14016000";
		mmsys_config = "/mmsys_config@14000000";
		mrdump_ext_rst = "/mrdump_ext_rst";
		msdc0 = "/msdc@11230000";
		msdc0_pins_default = "/msdc@11230000/msdc0@default";
		msdc0_register_setting_default = "/msdc@11230000/msdc0@register_default";
		msdc1 = "/msdc@11240000";
		msdc1_ins = "/msdc1_ins";
		msdc1_pins_ddr50 = "/msdc@11240000/msdc1@ddr50";
		msdc1_pins_default = "/msdc@11240000/msdc1@default";
		msdc1_pins_sdr104 = "/msdc@11240000/msdc1@sdr104";
		msdc1_pins_sdr50 = "/msdc@11240000/msdc1@sdr50";
		msdc1_register_setting_default = "/msdc@11240000/msdc1@register_default";
		mse = "/mse";
		mt_charger = "/mt_charger";
		mt_pmic_vaud28_ldo_reg = "/mt_pmic_regulator/ldo_regulators/ldo_vaud28";
		mt_pmic_vaux18_ldo_reg = "/mt_pmic_regulator/ldo_regulators/ldo_vaux18";
		mt_pmic_vcama_ldo_reg = "/mt_pmic_regulator/ldo_regulators/ldo_vcama";
		mt_pmic_vcamd_ldo_reg = "/mt_pmic_regulator/ldo_regulators/ldo_vcamd";
		mt_pmic_vcamio_ldo_reg = "/mt_pmic_regulator/ldo_regulators/ldo_vcamio";
		mt_pmic_vcn18_ldo_reg = "/mt_pmic_regulator/ldo_regulators/ldo_vcn18";
		mt_pmic_vcn28_ldo_reg = "/mt_pmic_regulator/ldo_regulators/ldo_vcn28";
		mt_pmic_vcn33_bt_ldo_reg = "/mt_pmic_regulator/ldo_regulators/ldo_vcn33_bt";
		mt_pmic_vcn33_wifi_ldo_reg = "/mt_pmic_regulator/ldo_regulators/ldo_vcn33_wifi";
		mt_pmic_vcore_buck_reg = "/mt_pmic_regulator/buck_regulators/buck_vcore";
		mt_pmic_vdram_ldo_reg = "/mt_pmic_regulator/ldo_regulators/ldo_vdram";
		mt_pmic_vefuse_ldo_reg = "/mt_pmic_regulator/ldo_regulators/ldo_vefuse";
		mt_pmic_vemc_ldo_reg = "/mt_pmic_regulator/ldo_regulators/ldo_vemc";
		mt_pmic_vfe28_ldo_reg = "/mt_pmic_regulator/ldo_regulators/ldo_vfe28";
		mt_pmic_vibr_ldo_reg = "/mt_pmic_regulator/ldo_regulators/ldo_vibr";
		mt_pmic_vio18_ldo_reg = "/mt_pmic_regulator/ldo_regulators/ldo_vio18";
		mt_pmic_vio28_ldo_reg = "/mt_pmic_regulator/ldo_regulators/ldo_vio28";
		mt_pmic_vldo28_ldo_reg = "/mt_pmic_regulator/ldo_regulators/ldo_vldo28";
		mt_pmic_vmc_ldo_reg = "/mt_pmic_regulator/ldo_regulators/ldo_vmc";
		mt_pmic_vmch_ldo_reg = "/mt_pmic_regulator/ldo_regulators/ldo_vmch";
		mt_pmic_vmodem_buck_reg = "/mt_pmic_regulator/buck_regulators/buck_vmodem";
		mt_pmic_vpa_buck_reg = "/mt_pmic_regulator/buck_regulators/buck_vpa";
		mt_pmic_vproc_buck_reg = "/mt_pmic_regulator/buck_regulators/buck_vproc";
		mt_pmic_vrf12_ldo_reg = "/mt_pmic_regulator/ldo_regulators/ldo_vrf12";
		mt_pmic_vrf18_ldo_reg = "/mt_pmic_regulator/ldo_regulators/ldo_vrf18";
		mt_pmic_vs1_buck_reg = "/mt_pmic_regulator/buck_regulators/buck_vs1";
		mt_pmic_vsim1_ldo_reg = "/mt_pmic_regulator/ldo_regulators/ldo_vsim1";
		mt_pmic_vsim2_ldo_reg = "/mt_pmic_regulator/ldo_regulators/ldo_vsim2";
		mt_pmic_vsram_others_ldo_reg = "/mt_pmic_regulator/ldo_regulators/ldo_vsram_others";
		mt_pmic_vsram_proc_ldo_reg = "/mt_pmic_regulator/ldo_regulators/ldo_vsram_proc";
		mt_pmic_vusb33_ldo_reg = "/mt_pmic_regulator/ldo_regulators/ldo_vusb33";
		mt_pmic_vxo22_ldo_reg = "/mt_pmic_regulator/ldo_regulators/ldo_vxo22";
		mtkfb = "/mtkfb";
		nfc = "/nfc";
		odm = "/odm";
		otg_iddig = "/otg_iddig";
		pio = "/pinctrl@1000b000";
		pmic_clock_buffer_ctrl = "/pmic_clock_buffer_ctrl";
		reserved_memory = "/reserved-memory";
		rt9465_slave_chr = "/rt9465_slave_chr";
		scpsys = "/scpsys@10001000";
		smi_larb0 = "/smi_larb0@14003000";
		smi_larb1 = "/smi_larb1@17010000";
		smi_larb2 = "/smi_larb2@15001000";
		spi0 = "/spi@1100a000";
		spi1 = "/spi@11010000";
		spi2 = "/spi@11012000";
		sub_flashlight_dummy = "/sub_flashlight_gpio";
		syscfg_pctl_a = "/syscfg_pctl_a@10005000";
		syscfg_pctl_bl = "/syscfg_pctl_bl@10002600";
		syscfg_pctl_bm = "/syscfg_pctl_bm@10002800";
		syscfg_pctl_lb = "/syscfg_pctl_lb@10002400";
		syscfg_pctl_lm = "/syscfg_pctl_lm@10002200";
		syscfg_pctl_lt = "/syscfg_pctl_lt@10002000";
		syscfg_pctl_rb = "/syscfg_pctl_rb@10002a00";
		syscfg_pctl_rt = "/syscfg_pctl_bl@10002c00";
		sysirq = "/intpol-controller@0x10200620";
		topckgen = "/topckgen@10000000";
		touch = "/touch";
		venc = "/venc@17020000";
		venc_global_con = "/venc_global_con@17000000";
	};

	accdet {
		compatible = "mediatek,pmic-accdet";
		linux,phandle = <0x3e>;
		phandle = <0x3e>;
	};

	aes_top0@10016000 {
		compatible = "mediatek,aes_top0";
		reg = <0x00 0x10016000 0x00 0x1000>;
	};

	als_ps@0 {
		compatible = "mediatek,als_ps";
		linux,phandle = <0x5f>;
		phandle = <0x5f>;
	};

	amms_control {
		compatible = "mediatek,amms";
		interrupts = <0x00 0x7b 0x01>;
	};

	ap_ccif0@10209000 {
		compatible = "mediatek,ap_ccif0";
		interrupts = <0x00 0x94 0x08>;
		reg = <0x00 0x10209000 0x00 0x1000>;
	};

	ap_ccif1@1020b000 {
		compatible = "mediatek,ap_ccif1";
		interrupts = <0x00 0x96 0x08>;
		reg = <0x00 0x1020b000 0x00 0x1000>;
	};

	ap_dma@11000000 {
		compatible = "mediatek,ap_dma";
		interrupts = <0x00 0x52 0x08>;
		reg = <0x00 0x11000000 0x00 0x1000>;
	};

	apcldmain@1021b000 {
		compatible = "mediatek,apcldmain";
		reg = <0x00 0x1021b000 0x00 0x00>;
	};

	apcldmain@1021b100 {
		compatible = "mediatek,apcldmain";
		reg = <0x00 0x1021b100 0x00 0x00>;
	};

	apcldmain_ao@10014000 {
		compatible = "mediatek,apcldmain_ao";
		reg = <0x00 0x10014000 0x00 0x400>;
	};

	apcldmamisc@1021b800 {
		compatible = "mediatek,apcldmamisc";
		interrupts = <0x00 0xa5 0x04>;
		reg = <0x00 0x1021b800 0x00 0x00>;
	};

	apcldmamisc@1021b900 {
		compatible = "mediatek,apcldmamisc";
		reg = <0x00 0x1021b900 0x00 0x400>;
	};

	apcldmamisc_ao@10014800 {
		compatible = "mediatek,apcldmamisc_ao";
		reg = <0x00 0x10014800 0x00 0x400>;
	};

	apcldmamisc_ao@10014c00 {
		compatible = "mediatek,apcldmamisc_ao";
		reg = <0x00 0x10014c00 0x00 0x400>;
	};

	apcldmaout@1021b400 {
		compatible = "mediatek,apcldmaout";
		reg = <0x00 0x1021b400 0x00 0x00>;
	};

	apcldmaout@1021b500 {
		compatible = "mediatek,apcldmaout";
		reg = <0x00 0x1021b500 0x00 0x00>;
	};

	apcldmaout_ao@10014400 {
		compatible = "mediatek,apcldmaout_ao";
		reg = <0x00 0x10014400 0x00 0x400>;
	};

	apmixed@1000c000 {
		#clock-cells = <0x01>;
		compatible = "mediatek,apmixed\0mediatek,apmixedsys\0syscon";
		linux,phandle = <0x32>;
		phandle = <0x32>;
		reg = <0x00 0x1000c000 0x00 0x1000>;
	};

	apuart0@11002000 {
		cell-index = <0x00>;
		clock-div = <0x01>;
		clock-frequency = <0x18cba80>;
		clock-names = "uart0-main\0uart-apdma";
		clocks = <0x19 0x14 0x19 0x28>;
		compatible = "mediatek,mtk-uart";
		interrupts = <0x00 0x5b 0x08 0x00 0x68 0x08 0x00 0x69 0x08>;
		linux,phandle = <0x41>;
		phandle = <0x41>;
		reg = <0x00 0x11002000 0x00 0x1000 0x00 0x11000400 0x00 0x80 0x00 0x11000480 0x00 0x80>;
	};

	apuart1@11003000 {
		cell-index = <0x01>;
		clock-div = <0x01>;
		clock-frequency = <0x18cba80>;
		clock-names = "uart1-main";
		clocks = <0x19 0x15>;
		compatible = "mediatek,mtk-uart";
		interrupts = <0x00 0x5c 0x08 0x00 0x6a 0x08 0x00 0x6b 0x08>;
		linux,phandle = <0x42>;
		phandle = <0x42>;
		reg = <0x00 0x11003000 0x00 0x1000 0x00 0x11000500 0x00 0x80 0x00 0x11000580 0x00 0x80>;
	};

	apxgpt@10008000 {
		clocks = <0x18>;
		compatible = "mediatek,apxgpt";
		interrupts = <0x00 0xa6 0x08>;
		reg = <0x00 0x10008000 0x00 0x1000>;
	};

	atf_logger {
		compatible = "mediatek,atf_logger";
		interrupts = <0x00 0xf1 0x01>;
	};

	audio@11220000 {
		#clock-cells = <0x01>;
		compatible = "mediatek,audio\0syscon";
		linux,phandle = <0x31>;
		phandle = <0x31>;
		reg = <0x00 0x11220000 0x00 0x1000>;
	};

	audio_sram@11221000 {
		compatible = "mediatek,audio_sram";
		reg = <0x00 0x11221000 0x00 0x9000>;
	};

	auxadc@11001000 {
		clock-names = "auxadc-main";
		clocks = <0x19 0x22>;
		compatible = "mediatek,auxadc";
		interrupts = <0x00 0x4a 0x02>;
		linux,phandle = <0x40>;
		phandle = <0x40>;
		reg = <0x00 0x11001000 0x00 0x1000>;
	};

	bat_gm30 {
		CAR_TUNE_VALUE = <0x52>;
		DIFFERENCE_FULLOCV_ITH = <0x96>;
		EMBEDDED_SEL = <0x00>;
		FG_METER_RESISTANCE = <0xc8>;
		KEEP_100_PERCENT = <0x02>;
		PMIC_SHUTDOWN_CURRENT = <0x14>;
		Q_MAX_SYS_VOLTAGE_BAT0 = <0xd48>;
		Q_MAX_SYS_VOLTAGE_BAT1 = <0xd48>;
		Q_MAX_SYS_VOLTAGE_BAT2 = <0xd48>;
		Q_MAX_SYS_VOLTAGE_BAT3 = <0xd48>;
		R_FG_VALUE = <0x0a>;
		SHUTDOWN_1_TIME = <0x3c>;
		TEMPERATURE_T0 = <0x32>;
		TEMPERATURE_T1 = <0x19>;
		TEMPERATURE_T2 = <0x0a>;
		TEMPERATURE_T3 = <0x00>;
		TEMPERATURE_T4 = <0xfffffff6>;
		battery0_profile_t0 = <0x00 0xaadc 0x454 0x12c 0xaa1e 0x454 0x258 0xa988 0x47b 0x384 0xa906 0x474 0x4b1 0xa884 0x474 0x5de 0xa802 0x479 0x70a 0xa780 0x472 0x836 0xa708 0x48b 0x962 0xa686 0x47b 0xbba 0xa596 0x483 0xce6 0xa51e 0x47b 0xe12 0xa49c 0x47b 0xf3e 0xa42e 0x48b 0x106a 0xa3b6 0x48b 0x1196 0xa33e 0x47c 0x12c2 0xa2da 0x492 0x13ee 0xa262 0x47b 0x151a 0xa1f4 0x49a 0x1772 0xa10e 0x49a 0x189e 0xa0aa 0x4ab 0x19ca 0xa03c 0x4a9 0x1af6 0x9fce 0x4a4 0x1c22 0x9f60 0x4a1 0x1d4e 0x9efc 0x4a9 0x1e7a 0x9e98 0x4b3 0x1fa6 0x9e34 0x4b0 0x20d2 0x9dd0 0x4bf 0x232a 0x9d12 0x4c9 0x2456 0x9cae 0x4d1 0x2582 0x9c54 0x4d8 0x26ae 0x9bfa 0x4e7 0x27da 0x9ba0 0x4ef 0x2906 0x9b46 0x4ef 0x2a32 0x9af6 0x500 0x2b5e 0x9aa6 0x50f 0x2c8a 0x9a56 0x51e 0x2ee2 0x99b6 0x544 0x300e 0x9966 0x555 0x313a 0x9916 0x564 0x3266 0x98bc 0x564 0x3392 0x9844 0x53c 0x34be 0x97b8 0x4e0 0x35ea 0x9740 0x4ab 0x3716 0x96e6 0x49a 0x3842 0x9696 0x495 0x3a9a 0x961e 0x495 0x3bc6 0x95e2 0x48b 0x3cf2 0x95b0 0x48b 0x3e1e 0x957e 0x492 0x3f4a 0x954c 0x492 0x4076 0x951a 0x48b 0x41a2 0x94f2 0x48b 0x42ce 0x94ca 0x49a 0x43fa 0x9498 0x492 0x4654 0x9452 0x4a4 0x4781 0x942a 0x4ab 0x48ae 0x940c 0x4b0 0x49db 0x93ee 0x4b0 0x4b08 0x93d0 0x4b0 0x4c35 0x93b2 0x4c2 0x4d62 0x939e 0x4c9 0x4e8f 0x9380 0x4d0 0x4fbc 0x936c 0x4d8 0x5216 0x933a 0x4e9 0x5343 0x9326 0x4f6 0x5470 0x9308 0x4e0 0x559d 0x92cc 0x4b3 0x56ca 0x927c 0x495 0x57f7 0x9240 0x495 0x5924 0x9222 0x49a 0x5a51 0x9204 0x4a9 0x5b7e 0x91dc 0x4a1 0x5caa 0x91b4 0x4a1 0x5dd7 0x918c 0x49a 0x5f03 0x916e 0x49a 0x602f 0x915a 0x4a9 0x615b 0x9132 0x4ab 0x6287 0x910a 0x4b3 0x63b3 0x90d8 0x4ab 0x64df 0x909c 0x4b3 0x660b 0x9060 0x4a9 0x6738 0x902e 0x4b0 0x6864 0x8fe8 0x4b7 0x6990 0x8f98 0x4a4 0x6abc 0x8f70 0x492 0x6be8 0x8f70 0x4a1 0x6d14 0x8f66 0x4c2 0x6e40 0x8f52 0x4e0 0x6f6c 0x8f3e 0x500 0x7098 0x8f0c 0x517 0x71c4 0x8e76 0x505 0x72f1 0x8d04 0x51e 0x741e 0x8ae8 0x55d 0x754b 0x8804 0x607 0x7678 0x841c 0x6dd 0x7678 0x841c 0x6dd 0x7678 0x841c 0x6dd 0x7678 0x841c 0x6dd 0x7678 0x841c 0x6dd 0x7678 0x841c 0x6dd>;
		battery0_profile_t0_num = <0x64>;
		battery0_profile_t1 = <0x00 0xaae6 0x5d2 0x12c 0xaa32 0x5d2 0x259 0xa992 0x5c8 0x386 0xa8fc 0x5c0 0x4b3 0xa870 0x5c1 0x5e0 0xa7ee 0x5aa 0x70d 0xa76c 0x5a3 0x839 0xa6f4 0x5aa 0x965 0xa67c 0x5a3 0xbbd 0xa58c 0x5b2 0xcea 0xa51e 0x5aa 0xe16 0xa4a6 0x59b 0xf42 0xa438 0x5b2 0x106e 0xa3c0 0x5a7 0x119a 0xa352 0x5b1 0x12c7 0xa2e4 0x5b2 0x13f4 0xa276 0x5b9 0x1520 0xa208 0x5c1 0x1778 0xa136 0x5d0 0x18a4 0xa0c8 0x5da 0x19d0 0xa05a 0x5d7 0x1afc 0x9ff6 0x5f0 0x1c28 0x9f92 0x5f0 0x1d54 0x9f2e 0x5fd 0x1e81 0x9ed4 0x618 0x1fae 0x9ea2 0x654 0x20db 0x9e48 0x64d 0x2335 0x9d30 0x634 0x2462 0x9c9a 0x634 0x258f 0x9c22 0x634 0x26bc 0x9bc8 0x64a 0x27e8 0x9b82 0x65c 0x2915 0x9b50 0x684 0x2a42 0x9b1e 0x693 0x2b6e 0x9ad8 0x684 0x2c9a 0x9a92 0x690 0x2ef2 0x99fc 0x6b1 0x301e 0x99ac 0x6c0 0x314a 0x995c 0x6c0 0x3276 0x990c 0x6d9 0x33a3 0x98b2 0x6c0 0x34d0 0x984e 0x6a9 0x35fd 0x97e0 0x65c 0x372a 0x9768 0x60e 0x3857 0x9704 0x5c1 0x3ab1 0x9664 0x594 0x3bde 0x9628 0x58c 0x3d0b 0x95e2 0x57b 0x3e38 0x95b0 0x57b 0x3f65 0x9588 0x57d 0x4092 0x9556 0x57b 0x41bf 0x9524 0x57d 0x42ec 0x94fc 0x582 0x4419 0x94d4 0x582 0x4672 0x948e 0x594 0x479f 0x9466 0x58a 0x48cc 0x9448 0x58a 0x49f9 0x942a 0x599 0x4b26 0x940c 0x599 0x4c53 0x93ee 0x59b 0x4d80 0x93da 0x5b1 0x4eac 0x93bc 0x5b1 0x4fd9 0x93a8 0x5b9 0x5233 0x9380 0x5c1 0x5360 0x936c 0x5c1 0x548c 0x9362 0x5c8 0x55b8 0x934e 0x5d0 0x56e5 0x9344 0x5da 0x5812 0x9326 0x5c8 0x593f 0x9312 0x5b9 0x5a6c 0x92f4 0x5a7 0x5b98 0x92d6 0x598 0x5cc4 0x92b8 0x599 0x5df0 0x9290 0x591 0x5f1c 0x9268 0x59b 0x6048 0x924a 0x59b 0x6174 0x922c 0x5a3 0x62a1 0x920e 0x59b 0x63ce 0x91e6 0x5a3 0x64fa 0x91be 0x5a8 0x6626 0x918c 0x5a3 0x6752 0x9150 0x5aa 0x687e 0x911e 0x5b9 0x69aa 0x90e2 0x5b9 0x6ad6 0x90a6 0x5c1 0x6c02 0x9056 0x5c1 0x6d2e 0x901a 0x5c1 0x6e5a 0x9006 0x5d0 0x6f86 0x8ff2 0x5e1 0x70b2 0x8fe8 0x607 0x71de 0x8fca 0x62c 0x730a 0x8fac 0x67a 0x7436 0x8f52 0x6cf 0x7562 0x8e44 0x72e 0x768e 0x8c5a 0x837 0x77ba 0x8994 0xa4b 0x78e6 0x85c0 0xcd5 0x7a13 0x841c 0xe59 0x7a13 0x841c 0xe59 0x7a13 0x841c 0xe59>;
		battery0_profile_t1_num = <0x64>;
		battery0_profile_t2 = <0x00 0xa981 0x454 0x12c 0xa8fc 0x454 0x258 0xa873 0x47b 0x384 0xa7f1 0x474 0x4b0 0xa772 0x474 0x5dc 0xa6f9 0x479 0x708 0xa683 0x472 0x834 0xa60d 0x48b 0x960 0xa59b 0x47b 0xbb8 0xa4b2 0x483 0xce4 0xa443 0x47b 0xe10 0xa3d3 0x47b 0xf3c 0xa366 0x48b 0x1068 0xa2fa 0x48b 0x1194 0xa28d 0x47c 0x12c0 0xa224 0x492 0x13ec 0xa1b8 0x47b 0x1518 0xa151 0x49a 0x1770 0xa078 0x49a 0x189c 0xa012 0x4ab 0x19c8 0x9fa9 0x4a9 0x1af4 0x9f55 0x4a4 0x1c20 0x9f14 0x4a1 0x1d4c 0x9ee2 0x4a9 0x1e78 0x9e85 0x4b3 0x1fa4 0x9ded 0x4b0 0x20d0 0x9d39 0x4bf 0x2328 0x9c06 0x4c9 0x2454 0x9b9a 0x4d1 0x2580 0x9b43 0x4d8 0x26ac 0x9afc 0x4e7 0x27d8 0x9ac1 0x4ef 0x2904 0x9a92 0x4ef 0x2a30 0x9a5b 0x500 0x2b5c 0x9a13 0x50f 0x2c88 0x99bd 0x51e 0x2ee0 0x98f3 0x544 0x300c 0x988a 0x555 0x3138 0x9826 0x564 0x3264 0x97c0 0x564 0x3390 0x976c 0x53c 0x34bc 0x9719 0x4e0 0x35e8 0x96d1 0x4ab 0x3714 0x968d 0x49a 0x3840 0x964f 0x495 0x3a98 0x95dc 0x495 0x3bc4 0x95ab 0x48b 0x3cf0 0x9579 0x48b 0x3e1c 0x954e 0x492 0x3f48 0x951f 0x492 0x4074 0x94f7 0x48b 0x41a0 0x94d2 0x48b 0x42cc 0x94ad 0x49a 0x43f8 0x948b 0x492 0x4650 0x9443 0x4a4 0x477c 0x9427 0x4ab 0x48a8 0x940f 0x4b0 0x49d4 0x93f0 0x4b0 0x4b00 0x93d7 0x4b0 0x4c2c 0x93bb 0x4c2 0x4d58 0x93a5 0x4c9 0x4e84 0x9393 0x4d0 0x4fb0 0x9383 0x4d8 0x5208 0x9367 0x4e9 0x5334 0x935e 0x4f6 0x5460 0x934e 0x4e0 0x558c 0x9342 0x4b3 0x56b8 0x9332 0x495 0x57e4 0x931d 0x495 0x5910 0x9301 0x49a 0x5a3c 0x92e2 0x4a9 0x5b68 0x92c3 0x4a1 0x5c94 0x92a1 0x4a1 0x5dc0 0x927f 0x49a 0x5eec 0x925c 0x49a 0x6018 0x9237 0x4a9 0x6144 0x9209 0x4ab 0x6270 0x91d4 0x4b3 0x639c 0x9196 0x4ab 0x64c8 0x915e 0x4b3 0x65f4 0x912a 0x4a9 0x6720 0x90e2 0x4b0 0x684c 0x908b 0x4b7 0x6978 0x904d 0x4a4 0x6aa4 0x902e 0x492 0x6bd0 0x9013 0x4a1 0x6cfc 0x8ff7 0x4c2 0x6e28 0x8fd5 0x4e0 0x6f54 0x8f97 0x500 0x7080 0x8f1b 0x517 0x71ac 0x8e07 0x505 0x72d8 0x8c1a 0x51e 0x7404 0x8973 0x55d 0x7530 0x85ca 0x607 0x765c 0x841c 0x6dd 0x770e 0x841c 0x6dd 0x7742 0x841c 0x6dd 0x7760 0x841c 0x6dd 0x7776 0x841c 0x6dd 0x7788 0x841c 0x6dd>;
		battery0_profile_t2_num = <0x64>;
		battery0_profile_t3 = <0x00 0xab0e 0x1338 0x12d 0xaa6e 0x1338 0x259 0xa9ec 0x139e 0x385 0xa94c 0x1359 0x4b1 0xa8d4 0x1359 0x5dd 0xa83e 0x1312 0x709 0xa7c6 0x12f4 0x835 0xa74e 0x12de 0x961 0xa6cc 0x12bd 0xbb9 0xa5e6 0x1270 0xce5 0xa56e 0x1261 0xe11 0xa500 0x123c 0xf3e 0xa488 0x1214 0x106b 0xa41a 0x1202 0x1198 0xa3ac 0x11fd 0x12c5 0xa33e 0x11dc 0x13f2 0xa2d0 0x11dc 0x151f 0xa262 0x11c6 0x1779 0xa186 0x11bf 0x18a6 0xa118 0x11ad 0x19d3 0xa0b4 0x11bf 0x1b00 0xa046 0x11a8 0x1c2d 0x9fe2 0x118f 0x1d5a 0x9f88 0x1197 0x1e87 0x9f42 0x11cd 0x1fb4 0x9efc 0x121b 0x20e1 0x9ea2 0x1232 0x233b 0x9d4e 0x11bf 0x2468 0x9c90 0x1169 0x2595 0x9bf0 0x1124 0x26c2 0x9b64 0x10fc 0x27ee 0x9b00 0x10de 0x291a 0x9a9c 0x10c7 0x2a46 0x9a4c 0x10a7 0x2b72 0x9a06 0x1090 0x2c9e 0x99ca 0x1089 0x2ef6 0x993e 0x1063 0x3022 0x98ee 0x101d 0x314e 0x9894 0xfe6 0x327a 0x983a 0xfe6 0x33a6 0x97ea 0xfa8 0x34d2 0x979a 0xf8a 0x35fe 0x974a 0xf78 0x372a 0x9704 0xf80 0x3856 0x96be 0xf69 0x3aae 0x963c 0xf69 0x3bda 0x960a 0xf80 0x3d06 0x95d8 0xf80 0x3e32 0x959c 0xf87 0x3f5f 0x956a 0xf78 0x408c 0x9542 0xf87 0x41b9 0x9510 0xf91 0x42e6 0x94e8 0xfaf 0x4413 0x94c0 0xfaf 0x466d 0x947a 0xfc6 0x479a 0x9452 0xfee 0x48c7 0x9434 0xff5 0x49f4 0x9416 0xff5 0x4b20 0x93f8 0x1004 0x4c4c 0x93da 0x1013 0x4d78 0x93c6 0x102a 0x4ea4 0x93b2 0x1043 0x4fd1 0x939e 0x1052 0x522b 0x938a 0x1086 0x5357 0x9380 0x109f 0x5484 0x9376 0x10cf 0x55b1 0x936c 0x10fc 0x56de 0x9358 0x111c 0x580b 0x934e 0x1149 0x5938 0x933a 0x116a 0x5a65 0x9326 0x1197 0x5b91 0x9312 0x11ec 0x5cbd 0x92f4 0x121b 0x5dea 0x92d6 0x1269 0x5f17 0x92b8 0x12b6 0x6044 0x929a 0x130b 0x6170 0x9272 0x1377 0x629c 0x9240 0x13d3 0x63c8 0x920e 0x1458 0x64f4 0x91dc 0x14fa 0x6620 0x9196 0x1570 0x674c 0x9164 0x163f 0x6878 0x911e 0x1720 0x69a4 0x90ce 0x1838 0x6ad0 0x907e 0x1967 0x6bfc 0x9042 0x1adb 0x6d28 0x901a 0x1c75 0x6e54 0x8fe8 0x1e75 0x6f80 0x8fac 0x209c 0x70ad 0x8f52 0x2326 0x71da 0x8ec6 0x260f 0x7307 0x8de0 0x290e 0x7434 0x8c3c 0x2bf0 0x7561 0x89da 0x2f8f 0x768e 0x86b0 0x3514 0x77bb 0x841c 0x3e76 0x77bb 0x841c 0x3e76 0x77bb 0x841c 0x3e76 0x77bb 0x841c 0x3e76 0x77bb 0x841c 0x3e76>;
		battery0_profile_t3_num = <0x64>;
		battery0_profile_t4 = <0x00 0xab40 0x20da 0x1e 0xaa50 0x20da 0x3c 0xa992 0x244d 0x5a 0xa8e8 0x2445 0x78 0xa848 0x242f 0x96 0xa7bc 0x2406 0xb4 0xa73a 0x23ff 0xd2 0xa6b8 0x23cb 0xf0 0xa636 0x239b 0xbb9 0xa546 0x233e 0xce6 0xa4d8 0x2300 0xe13 0xa460 0x22d8 0xf40 0xa3f2 0x22ab 0x106d 0xa384 0x2292 0x119a 0xa316 0x2274 0x12c7 0xa2a8 0x224c 0x13f4 0xa23a 0x223d 0x1521 0xa1cc 0x2206 0x177b 0xa0fa 0x21e0 0x18a8 0xa08c 0x21ac 0x19d5 0xa028 0x2184 0x1b02 0x9fce 0x217c 0x1c2f 0x9f7e 0x21b1 0x1d5c 0x9f38 0x21fa 0x1e89 0x9ede 0x2210 0x1fb6 0x9e5c 0x21e1 0x20e3 0x9db2 0x215c 0x233d 0x9c2c 0x203f 0x246a 0x9b8c 0x1fea 0x2597 0x9b0a 0x1fa9 0x26c4 0x9a9c 0x1f8e 0x27f1 0x9a42 0x1f5e 0x291d 0x99e8 0x1f4f 0x2a49 0x99ac 0x1f57 0x2b75 0x9966 0x1f57 0x2ca1 0x992a 0x1f4f 0x2ef9 0x98a8 0x1f48 0x3025 0x986c 0x1f45 0x3151 0x9826 0x1f27 0x327d 0x97d6 0x1f11 0x33a9 0x9790 0x1f02 0x34d5 0x974a 0x1ee9 0x3602 0x970e 0x1eda 0x372f 0x96c8 0x1eda 0x385c 0x968c 0x1eda 0x3ab6 0x9614 0x1f07 0x3be3 0x95d8 0x1eff 0x3d10 0x95a6 0x1f20 0x3e3d 0x9574 0x1f2e 0x3f6a 0x954c 0x1f4f 0x4097 0x951a 0x1f45 0x41c4 0x94f2 0x1f6d 0x42f1 0x94ca 0x1f93 0x441e 0x94a2 0x1fb3 0x4678 0x9452 0x1fdb 0x47a5 0x9434 0x2001 0x48d2 0x9416 0x2008 0x49ff 0x9402 0x2037 0x4b2c 0x93ee 0x2074 0x4c59 0x93da 0x20ab 0x4d86 0x93c6 0x20d7 0x4eb3 0x93bc 0x2120 0x4fe0 0x93a8 0x216b 0x523a 0x9394 0x2229 0x5367 0x9380 0x2283 0x5494 0x9376 0x22f1 0x55c1 0x9362 0x2373 0x56ee 0x9358 0x2409 0x581b 0x9344 0x249a 0x5947 0x9330 0x252e 0x5a73 0x931c 0x25c9 0x5b9f 0x92fe 0x2673 0x5ccb 0x92ea 0x2736 0x5df7 0x92c2 0x27ef 0x5f23 0x92ae 0x28f5 0x604f 0x9290 0x29e8 0x617b 0x9268 0x2afd 0x62a7 0x9236 0x2c0b 0x63d3 0x920e 0x2d53 0x64ff 0x91dc 0x2eb6 0x662b 0x91a0 0x3023 0x6757 0x916e 0x31ce 0x6883 0x9132 0x3389 0x69af 0x90ec 0x3591 0x6adb 0x90a6 0x37b4 0x6c07 0x906a 0x3a19 0x6d33 0x9024 0x3cb4 0x6e60 0x8fe8 0x3f66 0x6f8d 0x8fa2 0x4218 0x70ba 0x8f48 0x44ca 0x71e7 0x8eee 0x475c 0x7314 0x8e6c 0x49c8 0x7441 0x8db8 0x4c72 0x756e 0x8caa 0x4f9f 0x769b 0x8afc 0x5415 0x77c8 0x889a 0x5c03 0x7864 0x8700 0x5d78 0x78bf 0x85fc 0x5ada 0x78ff 0x8534 0x58dc 0x7931 0x841c 0x5758>;
		battery0_profile_t4_num = <0x64>;
		compatible = "mediatek,bat_gm30";
		g_FG_PSEUDO100_T0 = <0x62>;
		g_FG_PSEUDO100_T1 = <0x62>;
		g_FG_PSEUDO100_T2 = <0x5f>;
		g_FG_PSEUDO100_T3 = <0x5a>;
		g_FG_PSEUDO100_T4 = <0x56>;
		linux,phandle = <0x5a>;
		phandle = <0x5a>;
	};

	bpi_bsi_slv0@1021e000 {
		compatible = "mediatek,bpi_bsi_slv0";
		reg = <0x00 0x1021e000 0x00 0x1000>;
	};

	bpi_bsi_slv1@1021f000 {
		compatible = "mediatek,bpi_bsi_slv1";
		reg = <0x00 0x1021f000 0x00 0x6000>;
	};

	bpi_bsi_slv2@10225000 {
		compatible = "mediatek,bpi_bsi_slv2";
		reg = <0x00 0x10225000 0x00 0x1000>;
	};

	btcvsd@10001000 {
		compatible = "mediatek,audio_bt_cvsd";
		interrupts = <0x00 0xe8 0x08>;
		offset = <0xf00 0x800 0xfd0 0xfd4 0xfd8>;
		reg = <0x00 0x10001000 0x00 0x1000 0x00 0x18000000 0x00 0x10000 0x00 0x18080000 0x00 0x8000>;
	};

	btif@1100c000 {
		#address-cells = <0x02>;
		#size-cells = <0x02>;
		clock-names = "btifc\0apdmac";
		clocks = <0x19 0x1a 0x19 0x28>;
		compatible = "mediatek,btif";
		interrupts = <0x00 0x70 0x08 0x00 0x6c 0x08 0x00 0x6d 0x08>;
		reg = <0x00 0x1100c000 0x00 0x1000 0x00 0x11000600 0x00 0x80 0x00 0x11000680 0x00 0x80>;
	};

	bus_dbg@10208000 {
		compatible = "mediatek,bus_dbg-v2";
		interrupts = <0x00 0x8d 0x08>;
		mediatek,bus_dbg_con_offset = <0x2fc>;
		reg = <0x00 0x10208000 0x00 0x1000 0x00 0x10001000 0x00 0x1000>;
	};

	cam_a@15004000 {
		compatible = "mediatek,cam_a";
		reg = <0x00 0x15004000 0x00 0x1000>;
	};

	cam_a_inner@1500d000 {
		compatible = "mediatek,cam_a_inner";
		reg = <0x00 0x1500d000 0x00 0x1000>;
	};

	cam_b@15005000 {
		compatible = "mediatek,cam_b";
		interrupts = <0x00 0xd9 0x08>;
		reg = <0x00 0x15005000 0x00 0x1000>;
	};

	cam_c@15006000 {
		compatible = "mediatek,cam_c";
		interrupts = <0x00 0xda 0x08>;
		reg = <0x00 0x15006000 0x00 0x1000>;
	};

	cam_c_inner@1500e000 {
		compatible = "mediatek,cam_c_inner";
		reg = <0x00 0x1500e000 0x00 0x1000>;
	};

	cam_d@15007000 {
		compatible = "mediatek,cam_d";
		interrupts = <0x00 0xdb 0x08>;
		reg = <0x00 0x15007000 0x00 0x1000>;
	};

	cam_d_inner@1500f000 {
		compatible = "mediatek,cam_d_inner";
		reg = <0x00 0x1500f000 0x00 0x1000>;
	};

	camsv@15009000 {
		compatible = "mediatek,camsv";
		interrupts = <0x00 0xdc 0x08>;
		reg = <0x00 0x15009000 0x00 0x1000>;
	};

	charger {
		ac_charger_current = <0x118c30>;
		ac_charger_input_current = <0x1e8480>;
		algorithm_name = "SwitchCharging";
		apple_1_0a_charger_current = <0x118c30>;
		apple_2_1a_charger_current = <0x118c30>;
		battery_cv = <0x432380>;
		bif_cv_under_threshold2 = <0x43e6d0>;
		bif_threshold1 = <0x40d990>;
		bif_threshold2 = <0x419ce0>;
		cable_imp_threshold = <0x2bb>;
		charging_host_charger_current = <0x7a120>;
		chg1_ta_ac_charger_current = <0x16e360>;
		chg2_ta_ac_charger_current = <0x16e360>;
		chg_full_current = <0x249f0>;
		compatible = "mediatek,charger";
		enable_min_charge_temperature;
		enable_sw_safety_timer;
		jeita_temp_above_t4_cv_voltage = <0x40b280>;
		jeita_temp_below_t0_cv_voltage = <0x3da540>;
		jeita_temp_t0_to_t1_cv_voltage = <0x3da540>;
		jeita_temp_t1_to_t2_cv_voltage = <0x40b280>;
		jeita_temp_t2_to_t3_cv_voltage = <0x423920>;
		jeita_temp_t3_to_t4_cv_voltage = <0x40b280>;
		linux,phandle = <0x5c>;
		max_charge_temperature = <0x3a>;
		max_charge_temperature_minus_x_degree = <0x32>;
		max_charger_voltage = <0x632ea0>;
		max_charging_time = <0x54600>;
		min_charge_temperature = <0x00>;
		min_charge_temperature_plus_x_degree = <0x06>;
		non_std_ac_charger_current = <0x118c30>;
		pe20_ichg_level_threshold = <0x3e8>;
		phandle = <0x5c>;
		recharge_offset = <0x249f0>;
		ta_ac_charger_current = <0x2dc6c0>;
		ta_start_battery_soc = <0x00>;
		ta_stop_battery_soc = <0x55>;
		temp_neg_10_threshold = <0x00>;
		temp_t0_thres_plus_x_degree = <0x00>;
		temp_t0_threshold = <0x00>;
		temp_t1_thres_plus_x_degree = <0x06>;
		temp_t1_threshold = <0x00>;
		temp_t2_thres_plus_x_degree = <0x10>;
		temp_t2_threshold = <0x0a>;
		temp_t3_thres_minus_x_degree = <0x27>;
		temp_t3_threshold = <0x2d>;
		temp_t4_thres_minus_x_degree = <0x2f>;
		temp_t4_threshold = <0x32>;
		topoff_voltage = <0x401640>;
		usb_charger_current = <0x7a120>;
		usb_charger_current_configured = <0x7a120>;
		usb_charger_current_suspend = <0x00>;
		usb_charger_current_unconfigured = <0x11170>;
		vbat_cable_imp_threshold = <0xf3c>;
	};

	chipid@08000000 {
		compatible = "mediatek,chipid";
		reg = <0x00 0x8000000 0x00 0x04 0x00 0x8000004 0x00 0x04 0x00 0x8000008 0x00 0x04 0x00 0x800000c 0x00 0x04>;
	};

	chosen {
		bootargs = "console=tty0 console=ttyMT0,921600n1 root=/dev/ram initrd=0x44000000,0x1000000 loglevel=8 androidboot.selinux=permissive";
		linux,phandle = <0x38>;
		phandle = <0x38>;
	};

	chr_stat {
		linux,phandle = <0x65>;
		phandle = <0x65>;
	};

	clk26m {
		#clock-cells = <0x00>;
		clock-frequency = <0x18cba80>;
		compatible = "fixed-clock";
		linux,phandle = <0x25>;
		phandle = <0x25>;
	};

	clk32k {
		#clock-cells = <0x00>;
		clock-frequency = <0x7d00>;
		compatible = "fixed-clock";
		linux,phandle = <0x18>;
		phandle = <0x18>;
	};

	consys@18070000 {
		#address-cells = <0x02>;
		#size-cells = <0x02>;
		clock-names = "conn";
		clocks = <0x1a 0x03>;
		compatible = "mediatek,mt6739-consys";
		interrupts = <0x00 0xe9 0x08 0x00 0xeb 0x02>;
		linux,phandle = <0x5e>;
		phandle = <0x5e>;
		reg = <0x00 0x18070000 0x00 0x200 0x00 0x10007000 0x00 0x100 0x00 0x10000000 0x00 0x2000 0x00 0x10006000 0x00 0x1000>;
	};

	cpu_dbgapb {
		compatible = "mediatek,hw_dbg";
		linux,phandle = <0x39>;
		num = <0x04>;
		phandle = <0x39>;
		reg = <0x00 0xd410000 0x00 0x1000 0x00 0xd510000 0x00 0x1000 0x00 0xd610000 0x00 0x1000 0x00 0xd710000 0x00 0x1000>;
	};

	cpus {
		#address-cells = <0x01>;
		#size-cells = <0x00>;

		cpu-map {

			cluster0 {

				core0 {
					cpu = <0x0a>;
				};

				core1 {
					cpu = <0x0b>;
				};

				core2 {
					cpu = <0x0c>;
				};

				core3 {
					cpu = <0x0d>;
				};
			};
		};

		cpu@0 {
			clock-frequency = <0x77359400>;
			compatible = "arm,cortex-a53";
			cpu-idle-states = <0x03 0x04 0x05 0x06 0x07 0x08 0x09>;
			cpu-release-addr = <0x00 0x40000200>;
			device_type = "cpu";
			enable-method = "psci";
			linux,phandle = <0x0a>;
			phandle = <0x0a>;
			reg = <0x00>;
		};

		cpu@001 {
			clock-frequency = <0x61a1e580>;
			compatible = "arm,cortex-a53";
			cpu-idle-states = <0x03 0x04 0x05 0x06 0x07 0x08 0x09>;
			cpu-release-addr = <0x00 0x40000200>;
			device_type = "cpu";
			enable-method = "psci";
			linux,phandle = <0x0b>;
			phandle = <0x0b>;
			reg = <0x01>;
		};

		cpu@002 {
			clock-frequency = <0x61a1e580>;
			compatible = "arm,cortex-a53";
			cpu-idle-states = <0x03 0x04 0x05 0x06 0x07 0x08 0x09>;
			cpu-release-addr = <0x00 0x40000200>;
			device_type = "cpu";
			enable-method = "psci";
			linux,phandle = <0x0c>;
			phandle = <0x0c>;
			reg = <0x02>;
		};

		cpu@003 {
			clock-frequency = <0x61a1e580>;
			compatible = "arm,cortex-a53";
			cpu-idle-states = <0x03 0x04 0x05 0x06 0x07 0x08 0x09>;
			cpu-release-addr = <0x00 0x40000200>;
			device_type = "cpu";
			enable-method = "psci";
			linux,phandle = <0x0d>;
			phandle = <0x0d>;
			reg = <0x03>;
		};

		idle-states {
			entry-method = "arm,psci";

			dpidle {
				arm,psci-suspend-param = <0x1010004>;
				compatible = "arm,idle-state";
				entry-latency-us = <0x320>;
				exit-latency-us = <0x3e8>;
				linux,phandle = <0x08>;
				min-residency-us = <0x7d0>;
				phandle = <0x08>;
			};

			mcdi-cluster {
				arm,psci-suspend-param = <0x1010001>;
				compatible = "arm,idle-state";
				entry-latency-us = <0x258>;
				exit-latency-us = <0x258>;
				linux,phandle = <0x05>;
				min-residency-us = <0x4b0>;
				phandle = <0x05>;
			};

			mcdi-cpu {
				arm,psci-suspend-param = <0x10001>;
				compatible = "arm,idle-state";
				entry-latency-us = <0x258>;
				exit-latency-us = <0x258>;
				linux,phandle = <0x04>;
				min-residency-us = <0x4b0>;
				phandle = <0x04>;
			};

			sodi {
				arm,psci-suspend-param = <0x1010002>;
				compatible = "arm,idle-state";
				entry-latency-us = <0x320>;
				exit-latency-us = <0x3e8>;
				linux,phandle = <0x06>;
				min-residency-us = <0x7d0>;
				phandle = <0x06>;
			};

			sodi3 {
				arm,psci-suspend-param = <0x1010003>;
				compatible = "arm,idle-state";
				entry-latency-us = <0x320>;
				exit-latency-us = <0x3e8>;
				linux,phandle = <0x07>;
				min-residency-us = <0x7d0>;
				phandle = <0x07>;
			};

			standby {
				arm,psci-suspend-param = <0x01>;
				compatible = "arm,idle-state";
				entry-latency-us = <0x258>;
				exit-latency-us = <0x258>;
				linux,phandle = <0x03>;
				min-residency-us = <0x4b0>;
				phandle = <0x03>;
			};

			suspend {
				arm,psci-suspend-param = <0x1010005>;
				compatible = "arm,idle-state";
				entry-latency-us = <0x320>;
				exit-latency-us = <0x3e8>;
				linux,phandle = <0x09>;
				min-residency-us = <0x7d0>;
				phandle = <0x09>;
			};
		};
	};

	cq_dma@10212000 {
		clock-names = "cqdma";
		clocks = <0x19 0x44>;
		compatible = "mediatek,mt-cqdma-v1";
		interrupts = <0x00 0x72 0x08>;
		keep_clock_ao = "yes";
		nr_channel = <0x01>;
		reg = <0x00 0x10212080 0x00 0x80>;
	};

	dbg_apmcu_mp0@0d400000 {
		compatible = "mediatek,dbg_apmcu_mp0";
		reg = <0x00 0xd400000 0x00 0x1000>;
	};

	dbg_apmcu_mp0@0d410000 {
		compatible = "mediatek,dbg_apmcu_mp0";
		reg = <0x00 0xd410000 0x00 0x1000>;
	};

	dbg_apmcu_mp0@0d420000 {
		compatible = "mediatek,dbg_apmcu_mp0";
		reg = <0x00 0xd420000 0x00 0x1000>;
	};

	dbg_apmcu_mp0@0d430000 {
		compatible = "mediatek,dbg_apmcu_mp0";
		reg = <0x00 0xd430000 0x00 0x1000>;
	};

	dbg_apmcu_mp0@0d440000 {
		compatible = "mediatek,dbg_apmcu_mp0";
		reg = <0x00 0xd440000 0x00 0x1000>;
	};

	dbg_apmcu_mp0@0d510000 {
		compatible = "mediatek,dbg_apmcu_mp0";
		reg = <0x00 0xd510000 0x00 0x1000>;
	};

	dbg_apmcu_mp0@0d520000 {
		compatible = "mediatek,dbg_apmcu_mp0";
		reg = <0x00 0xd520000 0x00 0x1000>;
	};

	dbg_apmcu_mp0@0d530000 {
		compatible = "mediatek,dbg_apmcu_mp0";
		reg = <0x00 0xd530000 0x00 0x1000>;
	};

	dbg_apmcu_mp0@0d540000 {
		compatible = "mediatek,dbg_apmcu_mp0";
		reg = <0x00 0xd540000 0x00 0x1000>;
	};

	dbg_apmcu_mp0@0d610000 {
		compatible = "mediatek,dbg_apmcu_mp0";
		reg = <0x00 0xd610000 0x00 0x1000>;
	};

	dbg_apmcu_mp0@0d620000 {
		compatible = "mediatek,dbg_apmcu_mp0";
		reg = <0x00 0xd620000 0x00 0x1000>;
	};

	dbg_apmcu_mp0@0d630000 {
		compatible = "mediatek,dbg_apmcu_mp0";
		reg = <0x00 0xd630000 0x00 0x1000>;
	};

	dbg_apmcu_mp0@0d640000 {
		compatible = "mediatek,dbg_apmcu_mp0";
		reg = <0x00 0xd640000 0x00 0x1000>;
	};

	dbg_apmcu_mp0@0d710000 {
		compatible = "mediatek,dbg_apmcu_mp0";
		reg = <0x00 0xd710000 0x00 0x1000>;
	};

	dbg_apmcu_mp0@0d720000 {
		compatible = "mediatek,dbg_apmcu_mp0";
		reg = <0x00 0xd720000 0x00 0x1000>;
	};

	dbg_apmcu_mp0@0d730000 {
		compatible = "mediatek,dbg_apmcu_mp0";
		reg = <0x00 0xd730000 0x00 0x1000>;
	};

	dbg_apmcu_mp0@0d740000 {
		compatible = "mediatek,dbg_apmcu_mp0";
		reg = <0x00 0xd740000 0x00 0x1000>;
	};

	dbg_apmcu_mp1@0d800000 {
		compatible = "mediatek,dbg_apmcu_mp1";
		reg = <0x00 0xd800000 0x00 0x00>;
	};

	dbg_cti@0d020000 {
		compatible = "mediatek,dbg_cti";
		reg = <0x00 0xd020000 0x00 0x10000>;
	};

	dbg_dem@0d0a0000 {
		compatible = "mediatek,dbg_dem";
		interrupts = <0x00 0x8c 0x08>;
		reg = <0x00 0xd0a0000 0x00 0x10000>;
	};

	dbg_etb@0d010000 {
		compatible = "mediatek,dbg_etb";
		reg = <0x00 0xd010000 0x00 0x10000>;
	};

	dbg_etr@0d030000 {
		compatible = "mediatek,dbg_etr";
		reg = <0x00 0xd030000 0x00 0x10000>;
	};

	dbg_funnel@0d040000 {
		compatible = "mediatek,dbg_funnel";
		reg = <0x00 0xd040000 0x00 0x10000>;
	};

	dbg_mdsys1@0d0c0000 {
		compatible = "mediatek,dbg_mdsys1";
		reg = <0x00 0xd0c0000 0x00 0x40000>;
	};

	dbi0@14013000 {
		compatible = "mediatek,dbi0";
		interrupts = <0x00 0xd2 0x08>;
		reg = <0x00 0x14013000 0x00 0x1000>;
	};

	ddrphy@1001e000 {
		compatible = "mediatek,ddrphy";
		reg = <0x00 0x1001e000 0x00 0x1000>;
	};

	devapc@10207000 {
		clock-names = "devapc-infra-clock";
		clocks = <0x19 0x2a>;
		compatible = "mediatek,devapc";
		interrupts = <0x00 0x8e 0x08>;
		reg = <0x00 0x10207000 0x00 0x1000>;
	};

	dfd@0c600000 {
		compatible = "mediatek,dfd";
		reg = <0x00 0xc600000 0x00 0x00>;
	};

	disp_aal0@1400f000 {
		aal_support = <0x01>;
		compatible = "mediatek,disp_aal0";
		interrupts = <0x00 0xce 0x08>;
		linux,phandle = <0x56>;
		phandle = <0x56>;
		reg = <0x00 0x1400f000 0x00 0x1000>;
	};

	disp_ccorr0@1400e000 {
		compatible = "mediatek,disp_ccorr0";
		interrupts = <0x00 0xcd 0x08>;
		reg = <0x00 0x1400e000 0x00 0x1000>;
	};

	disp_color0@1400d000 {
		compatible = "mediatek,disp_color0";
		interrupts = <0x00 0xcc 0x08>;
		reg = <0x00 0x1400d000 0x00 0x1000>;
	};

	disp_dither0@14011000 {
		compatible = "mediatek,disp_dither0";
		interrupts = <0x00 0xd0 0x08>;
		reg = <0x00 0x14011000 0x00 0x1000>;
	};

	disp_gamma0@14010000 {
		compatible = "mediatek,disp_gamma0";
		interrupts = <0x00 0xcf 0x08>;
		reg = <0x00 0x14010000 0x00 0x1000>;
	};

	disp_mutex@14001000 {
		compatible = "mediatek,disp_mutex";
		interrupts = <0x00 0xc2 0x08>;
		linux,phandle = <0x22>;
		phandle = <0x22>;
		reg = <0x00 0x14001000 0x00 0x1000>;
	};

	disp_ovl0@1400a000 {
		clock-names = "DISP_OVL0";
		clocks = <0x1b 0x0c>;
		compatible = "mediatek,disp_ovl0";
		interrupts = <0x00 0xc9 0x08>;
		linux,phandle = <0x23>;
		phandle = <0x23>;
		reg = <0x00 0x1400a000 0x00 0x1000>;
	};

	disp_pwm0@1100e000 {
		compatible = "mediatek,disp_pwm0";
		reg = <0x00 0x1100e000 0x00 0x1000>;
	};

	disp_rdma0@1400b000 {
		compatible = "mediatek,disp_rdma0";
		interrupts = <0x00 0xca 0x08>;
		reg = <0x00 0x1400b000 0x00 0x1000>;
	};

	disp_wdma0@1400c000 {
		compatible = "mediatek,disp_wdma0";
		interrupts = <0x00 0xcb 0x08>;
		reg = <0x00 0x1400c000 0x00 0x1000>;
	};

	dispsys@14000000 {
		clock-names = "CLK_MM_MTCMOS\0CLK_MM_SMI_COMMON\0CLK_MM_SMI_LARB0\0CLK_MM_GALS_COMM0\0CLK_MM_GALS_COMM1\0CLK_MM_DISP_OVL0\0CLK_MM_DISP_RDMA0\0CLK_MM_DISP_WDMA0\0CLK_MM_DISP_COLOR0\0CLK_MM_DISP_CCORR0\0CLK_MM_DISP_AAL0\0CLK_MM_DISP_GAMMA0\0CLK_MM_DISP_DITHER0\0CLK_MM_DSI_MM_CLOCK\0CLK_MM_DSI_INTERF\0CLK_MM_F26M_HRT\0MDP_WROT0\0DISP_PWM\0MUX_PWM\0CLK26M\0UNIVPLL2_D4\0UNIVPLL2_D8\0UNIVPLL3_D8";
		clocks = <0x1a 0x04 0x1b 0x00 0x1b 0x01 0x1b 0x02 0x1b 0x03 0x1b 0x0c 0x1b 0x0d 0x1b 0x0e 0x1b 0x0f 0x1b 0x10 0x1b 0x11 0x1b 0x12 0x1b 0x13 0x1b 0x14 0x1b 0x15 0x1b 0x18 0x1b 0x09 0x19 0x33 0x24 0x39 0x25 0x24 0x19 0x24 0x1a 0x24 0x1f>;
		compatible = "mediatek,dispsys";
		linux,phandle = <0x57>;
		phandle = <0x57>;
	};

	dramc0@1001d000 {
		compatible = "mediatek,dramc0";
		reg = <0x00 0x1001d000 0x00 0x1000>;
	};

	dramc@1001d000 {
		compatible = "mediatek,dramc";
		reg = <0x00 0x1001d000 0x00 0x1000 0x00 0x1021d000 0x00 0x1000 0x00 0x1001e000 0x00 0x1000>;
	};

	dramc_ch0_rsv@1022e000 {
		compatible = "mediatek,dramc_ch0_rsv";
		reg = <0x00 0x1022e000 0x00 0x2000>;
	};

	dramc_ch0_top0@10228000 {
		compatible = "mediatek,dramc_ch0_top0";
		reg = <0x00 0x10228000 0x00 0x2000>;
	};

	dramc_ch0_top1@1022a000 {
		compatible = "mediatek,dramc_ch0_top1";
		reg = <0x00 0x1022a000 0x00 0x2000>;
	};

	dramc_ch0_top2@1022c000 {
		compatible = "mediatek,dramc_ch0_top2";
		reg = <0x00 0x1022c000 0x00 0x1000>;
	};

	dramc_ch0_top3@1022d000 {
		compatible = "mediatek,dramc_ch0_top3";
		reg = <0x00 0x1022d000 0x00 0x1000>;
	};

	dramc_ch1_rsv@10236000 {
		compatible = "mediatek,dramc_ch1_rsv";
		reg = <0x00 0x10236000 0x00 0x2000>;
	};

	dramc_ch1_top0@10230000 {
		compatible = "mediatek,dramc_ch1_top0";
		reg = <0x00 0x10230000 0x00 0x2000>;
	};

	dramc_ch1_top1@10232000 {
		compatible = "mediatek,dramc_ch1_top1";
		reg = <0x00 0x10232000 0x00 0x2000>;
	};

	dramc_ch1_top2@10234000 {
		compatible = "mediatek,dramc_ch1_top2";
		reg = <0x00 0x10234000 0x00 0x1000>;
	};

	dramc_ch1_top3@10235000 {
		compatible = "mediatek,dramc_ch1_top3";
		reg = <0x00 0x10235000 0x00 0x1000>;
	};

	dramc_nao@1021d000 {
		compatible = "mediatek,dramc_nao";
		reg = <0x00 0x1021d000 0x00 0x1000>;
	};

	dsi0@14012000 {
		compatible = "mediatek,dsi0";
		interrupts = <0x00 0xd1 0x08>;
		reg = <0x00 0x14012000 0x00 0x1000>;
	};

	dsi_te {
		compatible = "mediatek, dsi_te-eint";
		linux,phandle = <0x67>;
		phandle = <0x67>;
		status = "disabled";
	};

	dvfsp@10227000 {
		compatible = "mediatek,dvfsp";
		interrupts = <0x00 0xa3 0x08>;
		reg = <0x00 0x10227000 0x00 0x1000>;
	};

	dvfsrc_top@10012000 {
		compatible = "mediatek,dvfsrc_top";
		reg = <0x00 0x10012000 0x00 0x1000>;
	};

	dxcc_sec@10210000 {
		compatible = "mediatek,dxcc_sec";
		interrupts = <0x00 0xa2 0x04>;
		reg = <0x00 0x10210000 0x00 0x1000>;
	};

	eem_fsm@1100b000 {
		clock-names = "CLK_TOP_MFG\0CLK_TOP_MFG_OFF\0CLK_TOP_MFG_ON\0CG_SCP_SYS_MFG0\0CG_SCP_SYS_MFG1";
		clocks = <0x24 0x2d 0x24 0x00 0x24 0x20 0x1a 0x00 0x1a 0x01>;
		compatible = "mediatek,eem_fsm";
		interrupts = <0x00 0x7d 0x08>;
		reg = <0x00 0x1100b000 0x00 0x1000>;
	};

	efuse_dbg@10004000 {
		compatible = "mediatek,efuse_dbg";
		reg = <0x00 0x10004000 0x00 0x1000>;
	};

	efusec@11c00000 {
		compatible = "mediatek,efusec";
		reg = <0x00 0x11c00000 0x00 0x10000>;
	};

	emi@10219000 {
		compatible = "mediatek,emi";
		interrupts = <0x00 0x90 0x08 0x00 0x91 0x04 0x00 0x98 0x04>;
		reg = <0x00 0x10219000 0x00 0x1000 0x00 0x1021a000 0x00 0x1000 0x00 0x10226000 0x00 0x1000>;
	};

	fhctl@1000ce00 {
		compatible = "mediatek,fhctl";
		reg = <0x00 0x1000ce00 0x00 0x100>;
	};

	fingerprint {
		compatible = "mediatek,fingerprint";
		linux,phandle = <0x3b>;
		phandle = <0x3b>;
	};

	firmware {

		android {
			compatible = "android,firmware";

			fstab {
				compatible = "android,fstab";

				system {
					compatible = "android,system";
					dev = "/dev/block/platform/bootdevice/by-name/system";
					fsmgr_flags = "wait,verify";
					mnt_flags = "ro";
					type = "ext4";
				};

				vendor {
					compatible = "android,vendor";
					dev = "/dev/block/platform/bootdevice/by-name/vendor";
					fsmgr_flags = "wait,verify";
					mnt_flags = "ro";
					type = "ext4";
				};
			};
		};
	};

	flashlight_core {
		compatible = "mediatek,flashlight_core";
		linux,phandle = <0x50>;
		phandle = <0x50>;
	};

	flashlights_rt4505 {
		compatible = "mediatek,flashlights_rt4505";
		linux,phandle = <0x51>;
		phandle = <0x51>;
	};

	gauge_timer {
		compatible = "mediatek,gauge_timer_service";
	};

	gce@10228000 {
		ap_dma_base = <0x18010000 0x17 0xffff0000>;
		audio_base = <0x17000000 0x12 0xffff0000>;
		buf_underrun_event_0 = <0x8c>;
		buf_underrun_event_1 = <0x8d>;
		camsv_1_pass1_done = <0x107>;
		camsv_2_pass1_done = <0x106>;
		camsys1_base = <0x180a0000 0x1c 0xffff0000>;
		camsys2_base = <0x180b0000 0x1d 0xffff0000>;
		camsys_base = <0x18080000 0x1b 0xffff0000>;
		clock-names = "GCE\0GCE_TIMER";
		clocks = <0x19 0x07 0x19 0x18>;
		compatible = "mediatek,gce";
		conn_peri_base = <0x18820000 0x07 0xffff0000>;
		disp_aal0_frame_done = <0x1c>;
		disp_aal0_sof = <0x0b>;
		disp_ccorr0_frame_done = <0x1b>;
		disp_ccorr0_sof = <0x0a>;
		disp_color0_frame_done = <0x1a>;
		disp_color0_sof = <0x09>;
		disp_dbi0_frame_done = <0x20>;
		disp_dbi0_sof = <0x0f>;
		disp_dither0_frame_done = <0x1e>;
		disp_dither0_sof = <0x0d>;
		disp_dither_base = <0x14010000 0x02 0xffff0000>;
		disp_dsi0_frame_done = <0x1f>;
		disp_dsi0_sof = <0x0e>;
		disp_gamma0_frame_done = <0x1d>;
		disp_gamma0_sof = <0x0c>;
		disp_ovl0 = <0x23>;
		disp_ovl0_frame_done = <0x18>;
		disp_ovl0_frame_rst_done_pusle = <0x99>;
		disp_ovl0_sof = <0x06>;
		disp_pwm0_sof = <0x10>;
		disp_rdma0_frame_done = <0x11>;
		disp_rdma0_sof = <0x07>;
		disp_wdma0_frame_done = <0x19>;
		disp_wdma0_rst_done = <0x94>;
		disp_wdma0_sof = <0x08>;
		dsi0_done_event = <0x90>;
		dsi0_irq_event = <0x8f>;
		dsi0_te_event = <0x8e>;
		g3d_config_base = <0x13000000 0x00 0xffff0000>;
		gce_base = <0x18020000 0x18 0xffff0000>;
		gcpu_base = <0x10050000 0x0f 0xffff0000>;
		imgsys_base = <0x15020000 0x04 0xffff0000>;
		infra_na3_base = <0x10010000 0x0b 0xffff0000>;
		infra_na4_base = <0x10020000 0x0c 0xffff0000>;
		interrupts = <0x00 0x9a 0x08 0x00 0x9b 0x08>;
		isp_frame_done_p1_0 = <0x105>;
		isp_frame_done_p1_1 = <0x104>;
		isp_frame_done_p2_0 = <0x103>;
		isp_frame_done_p2_1 = <0x102>;
		isp_frame_done_p2_2 = <0x101>;
		jpgdec_done = <0x123>;
		jpgenc_done = <0x122>;
		kp_base = <0x18840000 0x09 0xffff0000>;
		max_prefetch_cnt = <0x01>;
		mcucfg_base = <0x10040000 0x0e 0xffff0000>;
		mdp_rdma0 = <0x1c>;
		mdp_rdma0_frame_done = <0x12>;
		mdp_rdma0_rst_done = <0x98>;
		mdp_rdma0_sof = <0x00>;
		mdp_rsz0 = <0x1d>;
		mdp_rsz0_frame_done = <0x13>;
		mdp_rsz0_sof = <0x01>;
		mdp_rsz1 = <0x1e>;
		mdp_rsz1_frame_done = <0x14>;
		mdp_rsz1_sof = <0x02>;
		mdp_tdshp0 = <0x21>;
		mdp_tdshp_frame_done = <0x15>;
		mdp_tdshp_sof = <0x05>;
		mdp_wdma0 = <0x1f>;
		mdp_wdma_frame_done = <0x17>;
		mdp_wdma_rst_done = <0x95>;
		mdp_wdma_sof = <0x03>;
		mdp_wrot0 = <0x20>;
		mdp_wrot0_rst_done = <0x96>;
		mdp_wrot0_sof = <0x04>;
		mdp_wrot0_write_frame_done = <0x16>;
		mm_mutex = <0x22>;
		mm_na_base = <0x14020000 0x03 0xffff0000>;
		mmsys_config = <0x1b>;
		mmsys_config_base = <0x14000000 0x01 0xffff0000>;
		msdc2_base = <0x17020000 0x14 0xffff0000>;
		msdc3_base = <0x18000000 0x16 0xffff0000>;
		prefetch_size = <0x60>;
		pwm_sw_base = <0x11000000 0x63 0xffff0000>;
		reg = <0x00 0x10228000 0x00 0x4000>;
		scp_base = <0x10030000 0x0d 0xffff0000>;
		scp_sram_base = <0x10000000 0x0a 0xffff0000>;
		seninf_cam0_fifo_full = <0x109>;
		seninf_cam1_2_3_fifo_full = <0x108>;
		sram_share_cnt = <0x01>;
		sram_share_engine = <0x08>;
		sram_share_event = <0x1e0>;
		sram_size_cpr_64 = <0x40>;
		stream_done_0 = <0x82>;
		stream_done_1 = <0x83>;
		stream_done_2 = <0x84>;
		stream_done_3 = <0x85>;
		stream_done_4 = <0x86>;
		stream_done_5 = <0x87>;
		stream_done_6 = <0x88>;
		stream_done_7 = <0x89>;
		stream_done_8 = <0x8a>;
		stream_done_9 = <0x8b>;
		topckgen_base = <0x18830000 0x08 0xffff0000>;
		usb0_base = <0x10200000 0x10 0xffff0000>;
		usb_sif_base = <0x10280000 0x11 0xffff0000>;
		vdec1_base = <0x17030000 0x15 0xffff0000>;
		vdec2_base = <0x18040000 0x19 0xffff0000>;
		vdec3_base = <0x18050000 0x1a 0xffff0000>;
		vdec_base = <0x17010000 0x13 0xffff0000>;
		vdec_gcon_base = <0x18800000 0x05 0xffff0000>;
		venc_128byte_cnt_done = <0x125>;
		venc_done = <0x121>;
		venc_gcon_base = <0x18810000 0x06 0xffff0000>;
		venc_mb_done = <0x124>;
	};

	gic500@0c000000 {
		compatible = "mediatek,gic500";
		reg = <0x00 0xc000000 0x00 0x00>;
	};

	gic_cpu@0c400000 {
		compatible = "mediatek,gic_cpu";
		reg = <0x00 0xc400000 0x00 0x40000>;
	};

	gpio {
		compatible = "mediatek,gpio_usage_mapping";
		linux,phandle = <0x3c>;
		phandle = <0x3c>;
	};

	gpio@10005000 {
		compatible = "mediatek,gpio";
		linux,phandle = <0x3d>;
		phandle = <0x3d>;
		reg = <0x00 0x10005000 0x00 0x1000>;
	};

	gps {
		compatible = "mediatek,gps";
	};

	gpufreq {
		clock-names = "CLK_TOP_MFG\0CLK_TOP_MFG_OFF\0CLK_TOP_MFG_ON";
		clocks = <0x24 0x2d 0x25 0x24 0x20>;
		compatible = "mediatek,mt6739-gpufreq";
	};

	gse_1 {
		linux,phandle = <0x60>;
		phandle = <0x60>;
	};

	gyro {
		compatible = "mediatek,gyroscope";
		linux,phandle = <0x62>;
		phandle = <0x62>;
	};

	hacc@1000a000 {
		compatible = "mediatek,hacc";
		interrupts = <0x00 0xb5 0x08>;
		reg = <0x00 0x1000a000 0x00 0x1000>;
	};

	i2c@11007000 {
		aed = <0x1f>;
		clock-div = <0x05>;
		clock-names = "main\0dma";
		clocks = <0x19 0x09 0x19 0x28>;
		compatible = "mediatek,mt6739-i2c";
		id = <0x00>;
		interrupts = <0x00 0x54 0x08>;
		linux,phandle = <0x43>;
		phandle = <0x43>;
		reg = <0x00 0x11007000 0x00 0x1000 0x00 0x11000100 0x00 0x80>;
	};

	i2c@11008000 {
		aed = <0x1f>;
		clock-div = <0x05>;
		clock-names = "main\0dma";
		clocks = <0x19 0x0a 0x19 0x28>;
		compatible = "mediatek,mt6739-i2c";
		id = <0x01>;
		interrupts = <0x00 0x55 0x08>;
		linux,phandle = <0x44>;
		phandle = <0x44>;
		reg = <0x00 0x11008000 0x00 0x1000 0x00 0x11000180 0x00 0x80>;

		hl7005@6a {
			aicr = <0x7a120>;
			charger_name = "primary_chg";
			compatible = "halo,hl7005";
			cv = <0x426030>;
			ichg = <0x162010>;
			ieoc = <0x30d40>;
			mivr = <0x44aa20>;
			reg = <0x6a>;
			status = "okay";
			vmreg = <0x426030>;
		};
	};

	i2c@11009000 {
		aed = <0x1f>;
		clock-div = <0x05>;
		clock-names = "main\0dma";
		clocks = <0x19 0x0b 0x19 0x28>;
		compatible = "mediatek,mt6739-i2c";
		id = <0x02>;
		interrupts = <0x00 0x56 0x08>;
		linux,phandle = <0x45>;
		phandle = <0x45>;
		reg = <0x00 0x11009000 0x00 0x1000 0x00 0x11000200 0x00 0x80>;
	};

	i2c@1100f000 {
		aed = <0x1f>;
		clock-div = <0x05>;
		clock-names = "main\0dma";
		clocks = <0x19 0x0c 0x19 0x28>;
		compatible = "mediatek,mt6739-i2c";
		id = <0x03>;
		interrupts = <0x00 0x57 0x08>;
		linux,phandle = <0x46>;
		phandle = <0x46>;
		reg = <0x00 0x1100f000 0x00 0x1000 0x00 0x11000280 0x00 0x80>;
	};

	i2c@11011000 {
		aed = <0x1f>;
		clock-div = <0x05>;
		clock-names = "main\0dma";
		clocks = <0x19 0x37 0x19 0x28>;
		compatible = "mediatek,mt6739-i2c";
		id = <0x04>;
		interrupts = <0x00 0x58 0x08>;
		linux,phandle = <0x47>;
		phandle = <0x47>;
		reg = <0x00 0x11011000 0x00 0x1000 0x00 0x11000300 0x00 0x80>;
	};

	i2c@11016000 {
		aed = <0x1f>;
		clock-div = <0x05>;
		clock-names = "main\0dma";
		clocks = <0x19 0x3b 0x19 0x28>;
		compatible = "mediatek,mt6739-i2c";
		id = <0x05>;
		interrupts = <0x00 0x82 0x08>;
		linux,phandle = <0x48>;
		phandle = <0x48>;
		reg = <0x00 0x11016000 0x00 0x1000 0x00 0x11000380 0x00 0x80>;
	};

	imgsys_config@15000000 {
		#clock-cells = <0x01>;
		compatible = "mediatek,imgsys\0syscon";
		linux,phandle = <0x36>;
		phandle = <0x36>;
		reg = <0x00 0x15000000 0x00 0x1000>;
	};

	infra_mbist@1020d000 {
		compatible = "mediatek,infra_mbist";
		reg = <0x00 0x1020d000 0x00 0x1000>;
	};

	infracfg@1020e000 {
		compatible = "mediatek,infracfg";
		reg = <0x00 0x1020e000 0x00 0x1000>;
	};

	infracfg_ao@10001000 {
		#clock-cells = <0x01>;
		compatible = "mediatek,infracfg_ao\0syscon";
		interrupts = <0x00 0x93 0x01>;
		linux,phandle = <0x19>;
		phandle = <0x19>;
		reg = <0x00 0x10001000 0x00 0x1000>;
	};

	interrupt-controller@0c000000 {
		#address-cells = <0x02>;
		#interrupt-cells = <0x03>;
		#redistributor-regions = <0x01>;
		#size-cells = <0x02>;
		compatible = "arm,gic-v3";
		interrupt-controller;
		interrupt-parent = <0x02>;
		interrupts = <0x01 0x09 0x04>;
		linux,phandle = <0x02>;
		mediatek,reg_len_pol0 = <0x08>;
		phandle = <0x02>;
		reg = <0x00 0xc000000 0x00 0x40000 0x00 0xc080000 0x00 0x200000 0x00 0x10200620 0x00 0x1000>;
	};

	intpol-controller@0x10200620 {
		#interrupt-cells = <0x03>;
		compatible = "mediatek,mt6739-sysirq\0mediatek,mt6577-sysirq";
		interrupt-controller;
		interrupt-parent = <0x02>;
		linux,phandle = <0x01>;
		phandle = <0x01>;
		reg = <0x00 0x10200620 0x00 0x20>;
	};

	io_cfg_bl@10002600 {
		compatible = "mediatek,io_cfg_bl";
		reg = <0x00 0x10002600 0x00 0x200>;
	};

	io_cfg_bm@10002800 {
		compatible = "mediatek,io_cfg_bm";
		reg = <0x00 0x10002800 0x00 0x200>;
	};

	io_cfg_lb@10002400 {
		compatible = "mediatek,io_cfg_lb";
		reg = <0x00 0x10002400 0x00 0x200>;
	};

	io_cfg_lm@10002200 {
		compatible = "mediatek,io_cfg_lm";
		reg = <0x00 0x10002200 0x00 0x200>;
	};

	io_cfg_lt@10002000 {
		compatible = "mediatek,io_cfg_lt";
		reg = <0x00 0x10002000 0x00 0x200>;
	};

	io_cfg_rb@10002a00 {
		compatible = "mediatek,io_cfg_rb";
		reg = <0x00 0x10002a00 0x00 0x200>;
	};

	io_cfg_rt@10002c00 {
		compatible = "mediatek,io_cfg_rt";
		reg = <0x00 0x10002c00 0x00 0x200>;
	};

	iocfg_0@10002000 {
		compatible = "mediatek,iocfg_0";
		reg = <0x00 0x10002000 0x00 0x200>;
	};

	iocfg_1@10002200 {
		compatible = "mediatek,iocfg_1";
		reg = <0x00 0x10002200 0x00 0x200>;
	};

	iocfg_2@10002400 {
		compatible = "mediatek,iocfg_2";
		reg = <0x00 0x10002400 0x00 0x200>;
	};

	iocfg_3@10002600 {
		compatible = "mediatek,iocfg_3";
		reg = <0x00 0x10002600 0x00 0x200>;
	};

	iocfg_4@10002800 {
		compatible = "mediatek,iocfg_4";
		reg = <0x00 0x10002800 0x00 0x200>;
	};

	iocfg_5@10002a00 {
		compatible = "mediatek,iocfg_5";
		reg = <0x00 0x10002a00 0x00 0x200>;
	};

	irq_nfc {
		compatible = "mediatek,irq_nfc-eint";
		linux,phandle = <0x6b>;
		phandle = <0x6b>;
	};

	irtx@1100d000 {
		compatible = "mediatek,irtx";
		interrupts = <0x00 0x7f 0x08>;
		reg = <0x00 0x1100d000 0x00 0x1000>;
	};

	irtx_pwm {
		compatible = "mediatek,irtx-pwm";
		linux,phandle = <0x6e>;
		phandle = <0x6e>;
		pwm_ch = <0x01>;
		pwm_data_invert = <0x00>;
	};

	ispsys@15000000 {
		clock-names = "CG_SCP_SYS_MM0\0CG_SCP_SYS_ISP\0CG_IMG_CAM_SMI\0CG_IMG_CAM_CAM\0CG_IMG_SEN_TG\0CG_IMG_SEN_CAM\0CG_IMG_CAM_SV";
		clocks = <0x1a 0x04 0x1a 0x05 0x36 0x01 0x36 0x02 0x36 0x03 0x36 0x04 0x36 0x05>;
		compatible = "mediatek,mt6739-ispsys";
		interrupts = <0x00 0xd9 0x08 0x00 0xda 0x08 0x00 0xdb 0x08 0x00 0xdc 0x08 0x00 0xdd 0x08>;
		reg = <0x00 0x15004000 0x00 0x9000 0x00 0x1500d000 0x00 0x1000 0x00 0x15000000 0x00 0x10000 0x00 0x10215000 0x00 0x3000 0x00 0x10211000 0x00 0x1000>;
	};

	kd_camera_hw1@15008000 {
		clock-names = "CLK_TOP_CAMTG_SEL\0CLK_TOP_CAMTG2_SEL\0CLK_TOP_CLK26M\0CLK_TOP_UNIVPLL_48M_D2\0CLK_TOP_UNIVPLL2_D8\0CLK_TOP_UNIVPLL_D26\0CLK_TOP_UNIVPLL2_D32\0CLK_TOP_UNIVPLL_48M_D4\0CLK_TOP_UNIVPLL_48M_D8\0CLK_TOP_SENINF_SEL\0CLK_TOP_SCAM_SEL";
		clocks = <0x24 0x2e 0x24 0x41 0x25 0x24 0x11 0x24 0x1a 0x24 0x10 0x24 0x1b 0x24 0x12 0x24 0x13 0x24 0x3f 0x24 0x37>;
		compatible = "mediatek,camera_hw";
		linux,phandle = <0x68>;
		phandle = <0x68>;
		reg = <0x00 0x15008000 0x00 0x1000>;
	};

	kp@10010000 {
		compatible = "mediatek,kp";
		interrupts = <0x00 0xb0 0x02>;
		linux,phandle = <0x16>;
		phandle = <0x16>;
		reg = <0x00 0x10010000 0x00 0x1000>;
	};

	leds_mt65xx {
		compatible = "mediatek,leds_mt65xx";
		linux,phandle = <0x54>;
		phandle = <0x54>;
	};

	m4u@10205000 {
		cell-index = <0x00>;
		compatible = "mediatek,m4u";
		interrupts = <0x00 0x9e 0x08>;
		reg = <0x00 0x10205000 0x00 0x1000>;
	};

	main_flashlight_gpio {
		compatible = "mediatek,flashlights_main_gpio";
		linux,phandle = <0x52>;
		phandle = <0x52>;
	};

	mbist_ao@10013000 {
		compatible = "mediatek,mbist_ao";
		reg = <0x00 0x10013000 0x00 0x1000>;
	};

	mcdi@10216000 {
		compatible = "mediatek,mt6739-mcdi";
		reg = <0x00 0x10fc00 0x00 0x400 0x00 0x10216000 0x00 0x1000 0x00 0x10217000 0x00 0x2000>;
	};

	mcucfg@10200000 {
		compatible = "mediatek,mcucfg";
		interrupts = <0x00 0x00 0x08>;
		reg = <0x00 0x10200000 0x00 0x1000>;
	};

	md1_sim1_hot_plug_eint {
		linux,phandle = <0x6c>;
		phandle = <0x6c>;
	};

	md1_sim2_hot_plug_eint {
		linux,phandle = <0x6d>;
		phandle = <0x6d>;
	};

	md2md_md1_ccif0@10211000 {
		compatible = "mediatek,md2md_md1_ccif0";
		reg = <0x00 0x10211000 0x00 0x1000>;
	};

	md2md_md2_ccif0@10213000 {
		compatible = "mediatek,md2md_md2_ccif0";
		reg = <0x00 0x10213000 0x00 0x1000>;
	};

	md_ccif0@1020a000 {
		compatible = "mediatek,md_ccif0";
		reg = <0x00 0x1020a000 0x00 0x1000>;
	};

	md_ccif1@1020c000 {
		compatible = "mediatek,md_ccif1";
		reg = <0x00 0x1020c000 0x00 0x1000>;
	};

	mdcldma@10014000 {
		clock-names = "scp-sys-md1-main\0infra-cldma-bclk\0infra-ccif-ap\0infra-ccif-md\0infra-ccif1-ap\0infra-ccif1-md";
		clocks = <0x1a 0x02 0x19 0x34 0x19 0x2b 0x19 0x2e 0x19 0x24 0x19 0x25>;
		compatible = "mediatek,mdcldma";
		interrupts = <0x00 0xa5 0x04 0x00 0x94 0x08 0x00 0x95 0x08 0x00 0xe3 0x02>;
		linux,phandle = <0x17>;
		mediatek,cldma_capability = <0x06>;
		mediatek,md_id = <0x00>;
		phandle = <0x17>;
		reg = <0x00 0x10014000 0x00 0x1000 0x00 0x1021b000 0x00 0x1000 0x00 0x10209000 0x00 0x1000 0x00 0x1020a000 0x00 0x1000>;
	};

	mdcldmain@1021c000 {
		compatible = "mediatek,mdcldmain";
		reg = <0x00 0x1021c000 0x00 0x400>;
	};

	mdcldmain_ao@10015000 {
		compatible = "mediatek,mdcldmain_ao";
		reg = <0x00 0x10015000 0x00 0x400>;
	};

	mdcldmamisc@1021c000 {
		compatible = "mediatek,mdcldmamisc";
		reg = <0x00 0x1021c000 0x00 0x00>;
	};

	mdcldmamisc@1021c900 {
		compatible = "mediatek,mdcldmamisc";
		reg = <0x00 0x1021c900 0x00 0x400>;
	};

	mdcldmamisc_ao@10015800 {
		compatible = "mediatek,mdcldmamisc_ao";
		reg = <0x00 0x10015800 0x00 0x400>;
	};

	mdcldmaout@1021c400 {
		compatible = "mediatek,mdcldmaout";
		reg = <0x00 0x1021c400 0x00 0x400>;
	};

	mdcldmaout_ao@10015400 {
		compatible = "mediatek,mdcldmaout_ao";
		reg = <0x00 0x10015400 0x00 0x400>;
	};

	mdp_rdma0@14004000 {
		clock-names = "MDP_RDMA0";
		clocks = <0x1b 0x05>;
		compatible = "mediatek,mdp_rdma0";
		interrupts = <0x00 0xc3 0x08>;
		linux,phandle = <0x1c>;
		phandle = <0x1c>;
		reg = <0x00 0x14004000 0x00 0x1000>;
	};

	mdp_rsz0@14005000 {
		clock-names = "MDP_RSZ0";
		clocks = <0x1b 0x06>;
		compatible = "mediatek,mdp_rsz0";
		interrupts = <0x00 0xc4 0x08>;
		linux,phandle = <0x1d>;
		phandle = <0x1d>;
		reg = <0x00 0x14005000 0x00 0x1000>;
	};

	mdp_rsz1@14006000 {
		clock-names = "MDP_RSZ1";
		clocks = <0x1b 0x07>;
		compatible = "mediatek,mdp_rsz1";
		interrupts = <0x00 0xc5 0x08>;
		linux,phandle = <0x1e>;
		phandle = <0x1e>;
		reg = <0x00 0x14006000 0x00 0x1000>;
	};

	mdp_tdshp0@14009000 {
		clock-names = "MDP_TDSHP";
		clocks = <0x1b 0x08>;
		compatible = "mediatek,mdp_tdshp0";
		linux,phandle = <0x21>;
		phandle = <0x21>;
		reg = <0x00 0x14009000 0x00 0x1000>;
	};

	mdp_wdma0@14007000 {
		clock-names = "MDP_WDMA";
		clocks = <0x1b 0x0a>;
		compatible = "mediatek,mdp_wdma0";
		interrupts = <0x00 0xc8 0x08>;
		linux,phandle = <0x1f>;
		phandle = <0x1f>;
		reg = <0x00 0x14007000 0x00 0x1000>;
	};

	mdp_wrot0@14008000 {
		clock-names = "MDP_WROT0";
		clocks = <0x1b 0x09>;
		compatible = "mediatek,mdp_wrot0";
		interrupts = <0x00 0xc7 0x08>;
		linux,phandle = <0x20>;
		phandle = <0x20>;
		reg = <0x00 0x14008000 0x00 0x1000>;
	};

	memory {
		device_type = "memory";
		reg = <0x00 0x40000000 0x00 0x20000000>;
	};

	mfg_auckland@13000000 {
		clock-frequency = <0x21f98280>;
		clock-names = "CLK_TOP_MFG\0CLK_TOP_MFG_OFF\0CLK_TOP_MFG_ON\0CG_SCP_SYS_MFG0\0CG_SCP_SYS_MFG1";
		clocks = <0x24 0x2d 0x25 0x24 0x20 0x1a 0x00 0x1a 0x01>;
		compatible = "mediatek,AUCKLAND";
		interrupt-names = "RGX";
		interrupts = <0x00 0xe2 0x08>;
		reg = <0x00 0x13000000 0x00 0x80000>;
	};

	mfg_cfg@13ffe000 {
		compatible = "mediatek,mt6739-mfg_cfg\0syscon";
		reg = <0x00 0x13ffe000 0x00 0x1000>;
	};

	mipi_rx_ana_csi0@11c10000 {
		compatible = "mediatek,mipi_rx_ana_csi0";
		reg = <0x00 0x11c10000 0x00 0x10000>;
	};

	mipi_rx_ana_csi1@11c20000 {
		compatible = "mediatek,mipi_rx_ana_csi1";
		reg = <0x00 0x11c20000 0x00 0x10000>;
	};

	mipi_tx0@11c80000 {
		compatible = "mediatek,mipi_tx0";
		reg = <0x00 0x11c80000 0x00 0x1000>;
	};

	mm_mutex@14016000 {
		compatible = "mediatek,mm_mutex";
		linux,phandle = <0x58>;
		phandle = <0x58>;
		reg = <0x00 0x14016000 0x00 0x00>;
	};

	mmsys_config@14000000 {
		#clock-cells = <0x01>;
		clock-names = "CAM_MDP";
		clocks = <0x1b 0x04>;
		compatible = "mediatek,mmsys_config\0syscon";
		interrupts = <0x00 0xd3 0x08>;
		linux,phandle = <0x1b>;
		phandle = <0x1b>;
		reg = <0x00 0x14000000 0x00 0x1000>;
	};

	mobicore {
		compatible = "trustonic,mobicore";
		interrupts = <0x00 0x6e 0x01>;
	};

	modem_temp_share@10018000 {
		compatible = "mediatek,modem_temp_share";
		reg = <0x00 0x10018000 0x00 0x1000>;
	};

	mrdump_ext_rst {
		compatible = "mediatek, mrdump_ext_rst-eint";
		linux,phandle = <0x63>;
		mode = "IRQ";
		phandle = <0x63>;
		source = "EINT";
		status = "okay";
	};

	msdc0_pad_macro@11cd0000 {
		compatible = "mediatek,msdc0_pad_macro";
		reg = <0x00 0x11cd0000 0x00 0x10000>;
	};

	msdc1_ins {
		linux,phandle = <0x64>;
		phandle = <0x64>;
	};

	msdc1_pad_macro@11c40000 {
		compatible = "mediatek,msdc1_pad_macro";
		reg = <0x00 0x11c40000 0x00 0x10000>;
	};

	msdc@11230000 {
		bus-width = <0x08>;
		cap-mmc-highspeed;
		clk_src = [01];
		clock-names = "msdc0-clock\0msdc0-hclock";
		clocks = <0x19 0x4b 0x19 0x1c>;
		compatible = "mediatek,msdc";
		host_function = [00];
		hw_dvfs = [00];
		index = [00];
		interrupts = <0x00 0x4f 0x08>;
		linux,phandle = <0x4c>;
		max-frequency = <0xbebc200>;
		mmc-ddr-1_8v;
		mmc-hs200-1_8v;
		mmc-hs400-1_8v;
		msdc-sys-suspend;
		non-removable;
		phandle = <0x4c>;
		pinctl = <0x26>;
		reg = <0x00 0x11230000 0x00 0x10000 0x00 0x11cd0000 0x00 0x10000>;
		register_setting = <0x27>;
		status = "okay";
		vmmc-supply = <0x28>;

		msdc0@default {
			linux,phandle = <0x26>;
			phandle = <0x26>;

			pins_clk {
				drive-strength = [04];
			};

			pins_cmd {
				drive-strength = [04];
			};

			pins_dat {
				drive-strength = [04];
			};

			pins_ds {
				drive-strength = [04];
			};

			pins_rst {
				drive-strength = [04];
			};
		};

		msdc0@register_default {
			cmd_edge = [00];
			linux,phandle = <0x27>;
			phandle = <0x27>;
			rdata_edge = [00];
			wdata_edge = [00];
		};
	};

	msdc@11240000 {
		bus-width = <0x04>;
		cap-sd-highspeed;
		cd-gpios = <0x2e 0x0f 0x00>;
		cd_level = [01];
		clk_src = [02];
		clock-names = "msdc1-clock\0msdc1-hclock";
		clocks = <0x19 0x4c 0x19 0x1d>;
		compatible = "mediatek,msdc";
		host_function = [01];
		hw_dvfs = [00];
		index = [01];
		interrupts = <0x00 0x50 0x08>;
		linux,phandle = <0x4d>;
		max-frequency = <0xbebc200>;
		msdc-sys-suspend;
		phandle = <0x4d>;
		pinctl = <0x29>;
		pinctl_ddr50 = <0x2c>;
		pinctl_sdr104 = <0x2a>;
		pinctl_sdr50 = <0x2b>;
		reg = <0x00 0x11240000 0x00 0x10000 0x00 0x11c40000 0x00 0x10000>;
		register_setting = <0x2d>;
		sd-uhs-ddr50;
		sd-uhs-sdr104;
		sd-uhs-sdr12;
		sd-uhs-sdr25;
		sd-uhs-sdr50;
		status = "okay";
		vmmc-supply = <0x2f>;
		vqmmc-supply = <0x30>;

		msdc1@ddr50 {
			linux,phandle = <0x2c>;
			phandle = <0x2c>;

			pins_clk {
				drive-strength = [03];
			};

			pins_cmd {
				drive-strength = [03];
			};

			pins_dat {
				drive-strength = [03];
			};
		};

		msdc1@default {
			linux,phandle = <0x29>;
			phandle = <0x29>;

			pins_clk {
				drive-strength = [03];
			};

			pins_cmd {
				drive-strength = [03];
			};

			pins_dat {
				drive-strength = [03];
			};
		};

		msdc1@register_default {
			cmd_edge = [00];
			linux,phandle = <0x2d>;
			phandle = <0x2d>;
			rdata_edge = [00];
			wdata_edge = [00];
		};

		msdc1@sdr104 {
			linux,phandle = <0x2a>;
			phandle = <0x2a>;

			pins_clk {
				drive-strength = [03];
			};

			pins_cmd {
				drive-strength = [03];
			};

			pins_dat {
				drive-strength = [03];
			};
		};

		msdc1@sdr50 {
			linux,phandle = <0x2b>;
			phandle = <0x2b>;

			pins_clk {
				drive-strength = [03];
			};

			pins_cmd {
				drive-strength = [03];
			};

			pins_dat {
				drive-strength = [03];
			};
		};
	};

	mse {
		linux,phandle = <0x61>;
		phandle = <0x61>;
	};

	mt6357_gauge {
		alias_name = "mt6357";
		compatible = "mediatek,mt6357_gauge";
		gauge_name = "gauge";
	};

	mt_charger {
		compatible = "mediatek,mt-charger";
		linux,phandle = <0x5b>;
		phandle = <0x5b>;
	};

	mt_pmic_regulator {
		compatible = "mediatek,mt_pmic";

		buck_regulators {
			compatible = "mediatek,mt_pmic_buck_regulators";

			buck_vcore {
				linux,phandle = <0x72>;
				phandle = <0x72>;
				regulator-enable-ramp-delay = <0xdc>;
				regulator-max-microvolt = <0x123716>;
				regulator-min-microvolt = <0x7ea5e>;
				regulator-name = "vcore";
				regulator-ramp-delay = <0x186a>;
			};

			buck_vmodem {
				linux,phandle = <0x71>;
				phandle = <0x71>;
				regulator-enable-ramp-delay = <0xdc>;
				regulator-max-microvolt = <0x123716>;
				regulator-min-microvolt = <0x7a120>;
				regulator-name = "vmodem";
				regulator-ramp-delay = <0x186a>;
			};

			buck_vpa {
				linux,phandle = <0x74>;
				phandle = <0x74>;
				regulator-enable-ramp-delay = <0xdc>;
				regulator-max-microvolt = <0x37b1d0>;
				regulator-min-microvolt = <0x7a120>;
				regulator-name = "vpa";
				regulator-ramp-delay = <0xc350>;
			};

			buck_vproc {
				linux,phandle = <0x73>;
				phandle = <0x73>;
				regulator-enable-ramp-delay = <0xdc>;
				regulator-max-microvolt = <0x1406f4>;
				regulator-min-microvolt = <0x7ea5e>;
				regulator-name = "vproc";
				regulator-ramp-delay = <0x186a>;
			};

			buck_vs1 {
				linux,phandle = <0x70>;
				phandle = <0x70>;
				regulator-enable-ramp-delay = <0xdc>;
				regulator-max-microvolt = <0x2191c0>;
				regulator-min-microvolt = <0x124f80>;
				regulator-name = "vs1";
				regulator-ramp-delay = <0x30d4>;
			};
		};

		ldo_regulators {
			compatible = "mediatek,mt_pmic_ldo_regulators";

			ldo_vaud28 {
				compatible = "regulator-fixed";
				linux,phandle = <0x85>;
				phandle = <0x85>;
				regulator-enable-ramp-delay = <0x108>;
				regulator-max-microvolt = <0x2ab980>;
				regulator-min-microvolt = <0x2ab980>;
				regulator-name = "vaud28";
			};

			ldo_vaux18 {
				compatible = "regulator-fixed";
				linux,phandle = <0x84>;
				phandle = <0x84>;
				regulator-enable-ramp-delay = <0x108>;
				regulator-max-microvolt = <0x1b7740>;
				regulator-min-microvolt = <0x1b7740>;
				regulator-name = "vaux18";
			};

			ldo_vcama {
				linux,phandle = <0x7e>;
				phandle = <0x7e>;
				regulator-enable-ramp-delay = <0x108>;
				regulator-max-microvolt = <0x2ab980>;
				regulator-min-microvolt = <0x2625a0>;
				regulator-name = "vcama";
			};

			ldo_vcamd {
				linux,phandle = <0x7f>;
				phandle = <0x7f>;
				regulator-enable-ramp-delay = <0x108>;
				regulator-max-microvolt = <0x1b7740>;
				regulator-min-microvolt = <0xf4240>;
				regulator-name = "vcamd";
			};

			ldo_vcamio {
				compatible = "regulator-fixed";
				linux,phandle = <0x80>;
				phandle = <0x80>;
				regulator-enable-ramp-delay = <0x108>;
				regulator-max-microvolt = <0x1b7740>;
				regulator-min-microvolt = <0x1b7740>;
				regulator-name = "vcamio";
			};

			ldo_vcn18 {
				compatible = "regulator-fixed";
				linux,phandle = <0x7d>;
				phandle = <0x7d>;
				regulator-enable-ramp-delay = <0x108>;
				regulator-max-microvolt = <0x1b7740>;
				regulator-min-microvolt = <0x1b7740>;
				regulator-name = "vcn18";
			};

			ldo_vcn28 {
				compatible = "regulator-fixed";
				linux,phandle = <0x7c>;
				phandle = <0x7c>;
				regulator-enable-ramp-delay = <0x108>;
				regulator-max-microvolt = <0x2ab980>;
				regulator-min-microvolt = <0x2ab980>;
				regulator-name = "vcn28";
			};

			ldo_vcn33_bt {
				linux,phandle = <0x7a>;
				phandle = <0x7a>;
				regulator-enable-ramp-delay = <0x108>;
				regulator-max-microvolt = <0x3567e0>;
				regulator-min-microvolt = <0x325aa0>;
				regulator-name = "vcn33_bt";
			};

			ldo_vcn33_wifi {
				linux,phandle = <0x7b>;
				phandle = <0x7b>;
				regulator-enable-ramp-delay = <0x108>;
				regulator-max-microvolt = <0x3567e0>;
				regulator-min-microvolt = <0x325aa0>;
				regulator-name = "vcn33_wifi";
			};

			ldo_vdram {
				linux,phandle = <0x88>;
				phandle = <0x88>;
				regulator-enable-ramp-delay = <0xce4>;
				regulator-max-microvolt = <0x124f80>;
				regulator-min-microvolt = <0x10c8e0>;
				regulator-name = "vdram";
			};

			ldo_vefuse {
				linux,phandle = <0x79>;
				phandle = <0x79>;
				regulator-enable-ramp-delay = <0x108>;
				regulator-max-microvolt = <0x325aa0>;
				regulator-min-microvolt = <0x124f80>;
				regulator-name = "vefuse";
			};

			ldo_vemc {
				linux,phandle = <0x28>;
				phandle = <0x28>;
				regulator-enable-ramp-delay = <0x2c>;
				regulator-max-microvolt = <0x325aa0>;
				regulator-min-microvolt = <0x2c4020>;
				regulator-name = "vemc";
			};

			ldo_vfe28 {
				compatible = "regulator-fixed";
				linux,phandle = <0x75>;
				phandle = <0x75>;
				regulator-enable-ramp-delay = <0x108>;
				regulator-max-microvolt = <0x2ab980>;
				regulator-min-microvolt = <0x2ab980>;
				regulator-name = "vfe28";
			};

			ldo_vibr {
				linux,phandle = <0x8b>;
				phandle = <0x8b>;
				regulator-enable-ramp-delay = <0x2c>;
				regulator-max-microvolt = <0x325aa0>;
				regulator-min-microvolt = <0x124f80>;
				regulator-name = "vibr";
			};

			ldo_vio18 {
				compatible = "regulator-fixed";
				linux,phandle = <0x87>;
				phandle = <0x87>;
				regulator-enable-ramp-delay = <0x108>;
				regulator-max-microvolt = <0x1b7740>;
				regulator-min-microvolt = <0x1b7740>;
				regulator-name = "vio18";
			};

			ldo_vio28 {
				compatible = "regulator-fixed";
				linux,phandle = <0x86>;
				phandle = <0x86>;
				regulator-enable-ramp-delay = <0x108>;
				regulator-max-microvolt = <0x2ab980>;
				regulator-min-microvolt = <0x2ab980>;
				regulator-name = "vio28";
			};

			ldo_vldo28 {
				linux,phandle = <0x81>;
				phandle = <0x81>;
				regulator-enable-ramp-delay = <0x108>;
				regulator-max-microvolt = <0x2dc6c0>;
				regulator-min-microvolt = <0x2ab980>;
				regulator-name = "vldo28";
			};

			ldo_vmc {
				linux,phandle = <0x30>;
				phandle = <0x30>;
				regulator-enable-ramp-delay = <0x2c>;
				regulator-max-microvolt = <0x325aa0>;
				regulator-min-microvolt = <0x1b7740>;
				regulator-name = "vmc";
			};

			ldo_vmch {
				linux,phandle = <0x2f>;
				phandle = <0x2f>;
				regulator-enable-ramp-delay = <0x2c>;
				regulator-max-microvolt = <0x325aa0>;
				regulator-min-microvolt = <0x2c4020>;
				regulator-name = "vmch";
			};

			ldo_vrf12 {
				compatible = "regulator-fixed";
				linux,phandle = <0x78>;
				phandle = <0x78>;
				regulator-enable-ramp-delay = <0x6e>;
				regulator-max-microvolt = <0x124f80>;
				regulator-min-microvolt = <0x124f80>;
				regulator-name = "vrf12";
			};

			ldo_vrf18 {
				compatible = "regulator-fixed";
				linux,phandle = <0x77>;
				phandle = <0x77>;
				regulator-enable-ramp-delay = <0x6e>;
				regulator-max-microvolt = <0x1b7740>;
				regulator-min-microvolt = <0x1b7740>;
				regulator-name = "vrf18";
			};

			ldo_vsim1 {
				linux,phandle = <0x89>;
				phandle = <0x89>;
				regulator-enable-ramp-delay = <0x108>;
				regulator-max-microvolt = <0x2f4d60>;
				regulator-min-microvolt = <0x19f0a0>;
				regulator-name = "vsim1";
			};

			ldo_vsim2 {
				linux,phandle = <0x8a>;
				phandle = <0x8a>;
				regulator-enable-ramp-delay = <0x108>;
				regulator-max-microvolt = <0x2f4d60>;
				regulator-min-microvolt = <0x19f0a0>;
				regulator-name = "vsim2";
			};

			ldo_vsram_others {
				linux,phandle = <0x82>;
				phandle = <0x82>;
				regulator-enable-ramp-delay = <0x6e>;
				regulator-max-microvolt = <0x1406f4>;
				regulator-min-microvolt = <0x7ea5e>;
				regulator-name = "vsram_others";
				regulator-ramp-delay = <0x186a>;
			};

			ldo_vsram_proc {
				linux,phandle = <0x83>;
				phandle = <0x83>;
				regulator-enable-ramp-delay = <0x6e>;
				regulator-max-microvolt = <0x1406f4>;
				regulator-min-microvolt = <0x7ea5e>;
				regulator-name = "vsram_proc";
				regulator-ramp-delay = <0x186a>;
			};

			ldo_vusb33 {
				linux,phandle = <0x8c>;
				phandle = <0x8c>;
				regulator-enable-ramp-delay = <0x108>;
				regulator-max-microvolt = <0x2f4d60>;
				regulator-min-microvolt = <0x2dc6c0>;
				regulator-name = "vusb33";
			};

			ldo_vxo22 {
				linux,phandle = <0x76>;
				phandle = <0x76>;
				regulator-enable-ramp-delay = <0x6e>;
				regulator-max-microvolt = <0x249f00>;
				regulator-min-microvolt = <0x2191c0>;
				regulator-name = "vxo22";
			};
		};
	};

	mt_soc_anc_pcm {
		compatible = "mediatek,mt_soc_pcm_anc";
	};

	mt_soc_btcvsd_rx_pcm {
		compatible = "mediatek,mt_soc_btcvsd_rx_pcm";
	};

	mt_soc_btcvsd_tx_pcm {
		compatible = "mediatek,mt_soc_btcvsd_tx_pcm";
	};

	mt_soc_codec_dummy_name {
		compatible = "mediatek,mt_soc_codec_dummy";
	};

	mt_soc_codec_name {
		compatible = "mediatek,mt_soc_codec_63xx";
		use_hp_depop_flow = <0x00>;
		use_ul_260k = <0x00>;
	};

	mt_soc_dai_name {
		compatible = "mediatek,mt_soc_dai_stub";
	};

	mt_soc_deep_buffer_dl_pcm {
		compatible = "mediatek,mt_soc_pcm_deep_buffer_dl";
	};

	mt_soc_dl1_awb_pcm {
		compatible = "mediatek,mt_soc_pcm_dl1_awb";
	};

	mt_soc_dl1_pcm@11220000 {
		clock-names = "aud_afe_clk\0aud_dac_clk\0aud_dac_predis_clk\0aud_adc_clk\0aud_apll22m_clk\0aud_apll1_tuner_clk\0aud_tml_clk\0aud_infra_clk\0mtkaif_26m_clk\0top_mux_audio\0top_mux_audio_int\0top_sys_pll1_d4\0top_mux_aud_1\0top_apll1_ck\0top_mux_aud_eng1\0top_apll1_d8\0apmixed_apll1\0top_clk26m_clk";
		clocks = <0x31 0x00 0x31 0x04 0x31 0x05 0x31 0x03 0x31 0x01 0x31 0x02 0x31 0x06 0x19 0x2d 0x19 0x35 0x24 0x34 0x24 0x35 0x24 0x03 0x24 0x38 0x24 0x24 0x24 0x42 0x24 0x27 0x32 0x06 0x25>;
		compatible = "mediatek,mt_soc_pcm_dl1";
		interrupts = <0x00 0x99 0x08>;
		linux,phandle = <0x4e>;
		phandle = <0x4e>;
		reg = <0x00 0x11220000 0x00 0x1000>;
	};

	mt_soc_dl2_pcm {
		compatible = "mediatek,mt_soc_pcm_dl2";
	};

	mt_soc_dummy_pcm {
		compatible = "mediatek,mt_soc_pcm_dummy";
	};

	mt_soc_fm_i2s_awb_pcm {
		compatible = "mediatek,mt_soc_pcm_fm_i2s_awb";
	};

	mt_soc_fm_i2s_pcm {
		compatible = "mediatek,mt_soc_pcm_fm_i2s";
	};

	mt_soc_fm_mrgtx_pcm {
		compatible = "mediatek,mt_soc_pcm_fmtx";
	};

	mt_soc_hdmi_pcm {
		compatible = "mediatek,mt_soc_pcm_hdmi";
	};

	mt_soc_hp_impedance_pcm {
		compatible = "mediatek,mt_soc_pcm_hp_impedance";
	};

	mt_soc_i2s0_awb_pcm {
		compatible = "mediatek,mt_soc_pcm_i2s0_awb";
	};

	mt_soc_i2s0_pcm {
		compatible = "mediatek,mt_soc_pcm_dl1_i2s0";
	};

	mt_soc_i2s0dl1_pcm {
		compatible = "mediatek,mt_soc_pcm_dl1_i2s0dl1";
	};

	mt_soc_mrgrx_awb_pcm {
		compatible = "mediatek,mt_soc_pcm_mrgrx_awb";
	};

	mt_soc_mrgrx_pcm {
		compatible = "mediatek,mt_soc_pcm_mrgrx";
	};

	mt_soc_pcm_voice_ultra {
		compatible = "mediatek,mt_soc_pcm_voice_ultra";
	};

	mt_soc_pcm_voice_usb {
		compatible = "mediatek,mt_soc_pcm_voice_usb";
	};

	mt_soc_pcm_voice_usb_echoref {
		compatible = "mediatek,mt_soc_pcm_voice_usb_echoref";
	};

	mt_soc_routing_dai_name {
		compatible = "mediatek,mt_soc_dai_routing";
	};

	mt_soc_routing_pcm {
		compatible = "mediatek,mt_soc_pcm_routing";
	};

	mt_soc_tdmrx_pcm {
		compatible = "mediatek,mt_soc_tdm_capture";
	};

	mt_soc_ul1_pcm {
		compatible = "mediatek,mt_soc_pcm_capture";
	};

	mt_soc_ul2_pcm {
		compatible = "mediatek,mt_soc_pcm_capture2";
	};

	mt_soc_uldlloopback_pcm {
		compatible = "mediatek,mt_soc_pcm_uldlloopback";
	};

	mt_soc_voice_md1 {
		compatible = "mediatek,mt_soc_pcm_voice_md1";
	};

	mt_soc_voice_md1_bt {
		compatible = "mediatek,mt_soc_pcm_voice_md1_bt";
	};

	mt_soc_voice_md2 {
		compatible = "mediatek,mt_soc_pcm_voice_md2";
	};

	mt_soc_voice_md2_bt {
		compatible = "mediatek,mt_soc_pcm_voice_md2_bt";
	};

	mt_soc_voip_bt_in {
		compatible = "mediatek,mt_soc_pcm_bt_dai";
	};

	mt_soc_voip_bt_out {
		compatible = "mediatek,mt_soc_pcm_dl1_bt";
	};

	mtkfb {
		compatible = "mediatek,mtkfb";
		linux,phandle = <0x55>;
		phandle = <0x55>;
	};

	nfc {
		compatible = "mediatek,nfc-gpio-v2";
		gpio-irq = <0x0e>;
		gpio-irq-std = <0x2e 0x0e 0x00>;
		gpio-rst = <0x07>;
		gpio-rst-std = <0x2e 0x07 0x00>;
		linux,phandle = <0x6a>;
		phandle = <0x6a>;
	};

	nfi@11018000 {
		clock-names = "nfi2x_sel\0nfiecc_sel\0clk26m\0syspll2_d2\0syspll_d7\0syspll_d3\0syspll2_d4\0msdcpll_d2\0univpll1_d2\0univpll_d5\0syspll4_d2\0univpll2_d4\0syspll1_d2\0univpll2_d2\0syspll_d5\0infra_nfiecc\0infra_nfi\0infra_nfi_1x";
		clocks = <0x24 0x3a 0x24 0x3b 0x25 0x24 0x07 0x24 0x0c 0x24 0x06 0x24 0x08 0x24 0x23 0x24 0x15 0x24 0x1c 0x24 0x0d 0x24 0x19 0x24 0x02 0x24 0x18 0x24 0x09 0x19 0x1e 0x19 0x27 0x19 0x4f>;
		compatible = "mediatek,nfi";
		interrupts = <0x00 0x86 0x08>;
		reg = <0x00 0x11018000 0x00 0x1000>;
	};

	nfiecc@11019000 {
		compatible = "mediatek,nfiecc";
		interrupts = <0x00 0x87 0x08>;
		reg = <0x00 0x11019000 0x00 0x1000>;
	};

	odm {
		compatible = "simple-bus";
		linux,phandle = <0x6f>;
		phandle = <0x6f>;
	};

	otg_iddig {
		compatible = "mediatek,usb_iddig_bi_eint";
		linux,phandle = <0x69>;
		phandle = <0x69>;
	};

	pericfg@10003000 {
		compatible = "mediatek,pericfg";
		reg = <0x00 0x10003000 0x00 0x1000>;
	};

	pinctrl@1000b000 {
		#gpio-cells = <0x02>;
		#interrupt-cells = <0x04>;
		compatible = "mediatek,pinctrl";
		gpio-controller;
		interrupt-controller;
		interrupts = <0x00 0xa7 0x04>;
		linux,phandle = <0x2e>;
		mediatek,pctl-regmap = <0x0e 0x0f 0x10 0x11 0x12 0x13 0x14 0x15>;
		phandle = <0x2e>;
		pins-are-numbered;
		reg = <0x00 0x1000b000 0x00 0x1000>;
	};

	pmic_clock_buffer_ctrl {
		compatible = "mediatek,pmic_clock_buffer";
		linux,phandle = <0x5d>;
		mediatek,clkbuf-config = <0x02 0x01 0x01 0x02 0x00 0x00 0x00>;
		mediatek,clkbuf-driving-current = <0xffffffff 0xffffffff 0xffffffff 0xffffffff 0xffffffff 0xffffffff 0xffffffff>;
		mediatek,clkbuf-quantity = <0x07>;
		phandle = <0x5d>;
	};

	pmu {
		compatible = "arm,cortex-a7-pmu";
		interrupt-parent = <0x02>;
		interrupts = <0x01 0x07 0x08>;
	};

	psci {
		compatible = "arm,psci-0.2";
		method = "smc";
	};

	pwm@11006000 {
		clock-names = "PWM1-main\0PWM2-main\0PWM3-main\0PWM4-main\0PWM5-main\0PWM6-main\0PWM-HCLK-main\0PWM-main";
		clocks = <0x19 0x0e 0x19 0x0f 0x19 0x10 0x19 0x11 0x19 0x12 0x19 0x32 0x19 0x0d 0x19 0x13>;
		compatible = "mediatek,pwm";
		interrupts = <0x00 0x4d 0x08>;
		reg = <0x00 0x11006000 0x00 0x1000>;
	};

	pwrap@1000d000 {
		compatible = "mediatek,pwrap";
		interrupts = <0x00 0xaf 0x04>;
		reg = <0x00 0x1000d000 0x00 0x1000>;

		pmic_irq {
			compatible = "mediatek,pmic-eint";
			interrupt-controller;
			linux,phandle = <0x3f>;
			phandle = <0x3f>;
		};
	};

	reserved-memory {
		#address-cells = <0x02>;
		#size-cells = <0x02>;
		linux,phandle = <0x3a>;
		phandle = <0x3a>;
		ranges;

		consys-reserve-memory {
			#address-cells = <0x02>;
			#size-cells = <0x02>;
			alignment = <0x00 0x200000>;
			alloc-ranges = <0x00 0x40000000 0x00 0x38000000>;
			compatible = "mediatek,consys-reserve-memory";
			no-map;
			size = <0x00 0x200000>;
		};

		minirdump-reserved-memory@444f0000 {
			compatible = "mediatek,minirdump";
			reg = <0x00 0x444f0000 0x00 0x10000>;
		};

		pstore-reserved-memory@44410000 {
			compatible = "mediatek,pstore";
			reg = <0x00 0x44410000 0x00 0xe0000>;
		};

		ram_console-reserved-memory@44400000 {
			compatible = "mediatek,ram_console";
			reg = <0x00 0x44400000 0x00 0x10000>;
		};
	};

	rt9465_slave_chr {
		linux,phandle = <0x66>;
		phandle = <0x66>;
	};

	scpsys@10001000 {
		#clock-cells = <0x01>;
		compatible = "mediatek,scpsys";
		linux,phandle = <0x1a>;
		phandle = <0x1a>;
		reg = <0x00 0x10001000 0x00 0x1000 0x00 0x10006000 0x00 0x1000 0x00 0x1020e000 0x00 0x1000>;
	};

	security_ao@1001a000 {
		compatible = "mediatek,security_ao";
		reg = <0x00 0x1001a000 0x00 0x1000>;
	};

	seninf@15008000 {
		compatible = "mediatek,seninf";
		reg = <0x00 0x15008000 0x00 0x1000>;
	};

	sleep@10006000 {
		compatible = "mediatek,sleep";
		interrupts = <0x00 0xb1 0x08>;
		reg = <0x00 0x10006000 0x00 0x1000>;
		wakeup-source = <0x16 0x00 0x04 0x17 0x03 0x2000000>;
	};

	sleep_reg_md@1000f000 {
		compatible = "mediatek,sleep_reg_md";
		reg = <0x00 0x1000f000 0x00 0x1000>;
	};

	smi_common@14002000 {
		clock-names = "mtcmos-mm\0smi-common-gals0\0smi-common-gals1\0smi-common\0MMDVFS_CLK_TOP_MMPLL_CK\0mmdvfs_clk_top_vencpll_ck\0mmdvfs_clk_top_syspll2_d2";
		clocks = <0x1a 0x04 0x1b 0x02 0x1b 0x03 0x1b 0x00 0x24 0x2c 0x24 0x21 0x24 0x07>;
		compatible = "mediatek,smi_common";
		larbs = <0x33 0x34 0x35>;
		reg = <0x00 0x14002000 0x00 0x1000>;
	};

	smi_larb0@14003000 {
		clock-names = "mtcmos-mm\0mm-larb0";
		clocks = <0x1a 0x04 0x1b 0x01>;
		compatible = "mediatek,smi_larb0";
		interrupts = <0x00 0xdf 0x08>;
		linux,phandle = <0x33>;
		phandle = <0x33>;
		reg = <0x00 0x14003000 0x00 0x1000>;
	};

	smi_larb1@17010000 {
		clock-names = "mtcmos-ven\0venc-larb\0venc-venc";
		clocks = <0x1a 0x06 0x37 0x00 0x37 0x01>;
		compatible = "mediatek,smi_larb1";
		interrupts = <0x00 0xd5 0x08>;
		linux,phandle = <0x34>;
		phandle = <0x34>;
		reg = <0x00 0x17010000 0x00 0x1000>;
	};

	smi_larb2@15001000 {
		clock-names = "mtcmos-img\0img-larb2";
		clocks = <0x1a 0x05 0x36 0x00>;
		compatible = "mediatek,smi_larb2";
		interrupts = <0x00 0xde 0x08>;
		linux,phandle = <0x35>;
		phandle = <0x35>;
		reg = <0x00 0x15001000 0x00 0x1000>;
	};

	smi_larb3@17010000 {
		compatible = "mediatek,smi_larb3";
		interrupts = <0x00 0xe7 0x08>;
		reg = <0x00 0x17010000 0x00 0x1000>;
	};

	spi2@11010000 {
		compatible = "mediatek,spi2";
		interrupts = <0x00 0x80 0x08>;
		reg = <0x00 0x11010000 0x00 0x1000>;
	};

	spi3@11012000 {
		compatible = "mediatek,spi3";
		interrupts = <0x00 0x81 0x08>;
		reg = <0x00 0x11012000 0x00 0x00>;
	};

	spi4@11013000 {
		compatible = "mediatek,spi4";
		reg = <0x00 0x11013000 0x00 0x1000>;
	};

	spi@1100a000 {
		clock-names = "parent-clk\0sel-clk\0spi-clk";
		clocks = <0x24 0x0a 0x24 0x30 0x19 0x1b>;
		compatible = "mediatek,mt6739-spi";
		interrupts = <0x00 0x76 0x08>;
		linux,phandle = <0x49>;
		mediatek,pad-select = <0x00>;
		phandle = <0x49>;
		reg = <0x00 0x1100a000 0x00 0x1000>;
	};

	spi@11010000 {
		clock-names = "parent-clk\0sel-clk\0spi-clk";
		clocks = <0x24 0x0a 0x24 0x30 0x19 0x36>;
		compatible = "mediatek,mt6739-spi";
		interrupts = <0x00 0x7a 0x08>;
		linux,phandle = <0x4a>;
		mediatek,pad-select = <0x00>;
		phandle = <0x4a>;
		reg = <0x00 0x11010000 0x00 0x1000>;
	};

	spi@11012000 {
		clock-names = "parent-clk\0sel-clk\0spi-clk";
		clocks = <0x24 0x0a 0x24 0x30 0x19 0x39>;
		compatible = "mediatek,mt6739-spi";
		interrupts = <0x00 0x80 0x08>;
		linux,phandle = <0x4b>;
		mediatek,pad-select = <0x00>;
		phandle = <0x4b>;
		reg = <0x00 0x11012000 0x00 0x1000>;
	};

	sramrom@10214000 {
		compatible = "mediatek,sramrom";
		reg = <0x00 0x10214000 0x00 0x1000>;
	};

	sub_flashlight_gpio {
		compatible = "mediatek,flashlights_sub_gpio";
		linux,phandle = <0x53>;
		phandle = <0x53>;
	};

	sys_cirq@10204000 {
		compatible = "mediatek,sys_cirq";
		interrupts = <0x00 0xf0 0x08>;
		mediatek,cirq_num = <0xa8>;
		mediatek,spi_start_offset = <0x48>;
		reg = <0x00 0x10204000 0x00 0x1000>;
	};

	sys_timer@10017000 {
		compatible = "mediatek,sys_timer";
		interrupts = <0x00 0xba 0x04>;
		mediatek,sysram-size = <0x14>;
		reg = <0x00 0x10017000 0x00 0x1000 0x00 0x10ffec 0x00 0x14>;
	};

	syscfg_pctl_a@10005000 {
		compatible = "mediatek,pctl-a-syscfg\0syscon";
		linux,phandle = <0x0e>;
		phandle = <0x0e>;
		reg = <0x00 0x10005000 0x00 0x1000>;
	};

	syscfg_pctl_bl@10002600 {
		compatible = "mediatek,pctl-bl-syscfg\0syscon";
		linux,phandle = <0x12>;
		phandle = <0x12>;
		reg = <0x00 0x10002600 0x00 0x1000>;
	};

	syscfg_pctl_bl@10002c00 {
		compatible = "mediatek,pctl-rt-syscfg\0syscon";
		linux,phandle = <0x15>;
		phandle = <0x15>;
		reg = <0x00 0x10002c00 0x00 0x1000>;
	};

	syscfg_pctl_bm@10002800 {
		compatible = "mediatek,pctl-bm-syscfg\0syscon";
		linux,phandle = <0x13>;
		phandle = <0x13>;
		reg = <0x00 0x10002800 0x00 0x1000>;
	};

	syscfg_pctl_lb@10002400 {
		compatible = "mediatek,pctl-lb-syscfg\0syscon";
		linux,phandle = <0x11>;
		phandle = <0x11>;
		reg = <0x00 0x10002400 0x00 0x1000>;
	};

	syscfg_pctl_lm@10002200 {
		compatible = "mediatek,pctl-lm-syscfg\0syscon";
		linux,phandle = <0x10>;
		phandle = <0x10>;
		reg = <0x00 0x10002200 0x00 0x1000>;
	};

	syscfg_pctl_lt@10002000 {
		compatible = "mediatek,pctl-lt-syscfg\0syscon";
		linux,phandle = <0x0f>;
		phandle = <0x0f>;
		reg = <0x00 0x10002000 0x00 0x1000>;
	};

	syscfg_pctl_rb@10002a00 {
		compatible = "mediatek,pctl-rb-syscfg\0syscon";
		linux,phandle = <0x14>;
		phandle = <0x14>;
		reg = <0x00 0x10002a00 0x00 0x1000>;
	};

	therm_ctrl@1100b000 {
		clock-names = "therm-main";
		clocks = <0x19 0x08>;
		compatible = "mediatek,therm_ctrl";
		interrupts = <0x00 0x4e 0x08>;
		reg = <0x00 0x1100b000 0x00 0x1000>;
	};

	timer {
		clock-frequency = <0xc65d40>;
		compatible = "arm,armv8-timer";
		interrupt-parent = <0x02>;
		interrupts = <0x01 0x0d 0x08 0x01 0x0e 0x08 0x01 0x0b 0x08 0x01 0x0a 0x08>;
	};

	topckgen@10000000 {
		#clock-cells = <0x01>;
		compatible = "mediatek,topckgen\0syscon";
		linux,phandle = <0x24>;
		phandle = <0x24>;
		reg = <0x00 0x10000000 0x00 0x1000 0x00 0x1000c000 0x00 0x1000>;
	};

	topckgen_ao@1001b000 {
		compatible = "mediatek,topckgen_ao";
		reg = <0x00 0x1001b000 0x00 0x1000>;
	};

	topmisc@10011000 {
		compatible = "mediatek,topmisc";
		reg = <0x00 0x10011000 0x00 0x1000>;
	};

	toprgu@10007000 {
		compatible = "mediatek,toprgu";
		interrupts = <0x00 0x8b 0x00>;
		reg = <0x00 0x10007000 0x00 0x1000>;
	};

	touch {
		compatible = "mediatek,mt6739-touch";
		linux,phandle = <0x4f>;
		phandle = <0x4f>;
	};

	trng@1020f000 {
		compatible = "mediatek,trng";
		interrupts = <0x00 0xa1 0x08>;
		reg = <0x00 0x1020f000 0x00 0x1000>;
	};

	trusty {
		#address-cells = <0x02>;
		#size-cells = <0x02>;
		compatible = "android,trusty-smc-v1";
		ranges;

		irq {
			compatible = "android,trusty-irq-v1";
			ppi-interrupt-parent = <0x02>;
		};

		log {
			compatible = "android,trusty-log-v1";
		};

		mtee {
			compatible = "mediatek,trusty-mtee-v1";
		};

		virtio {
			compatible = "android,trusty-virtio-v1";
		};
	};

	usb0@11200000 {
		clock-names = "usb0\0usb0_clk_top_sel\0usb0_clk_univpll3_d4";
		clocks = <0x19 0x06 0x24 0x3c 0x24 0x1e>;
		compatible = "mediatek,mt6739-usb20";
		interrupts = <0x00 0x49 0x08>;
		mode = <0x02>;
		multipoint = <0x01>;
		num_eps = <0x10>;
		reg = <0x00 0x11200000 0x00 0x10000 0x00 0x11cc0000 0x00 0x10000>;
	};

	utos {
		compatible = "microtrust,utos";
		interrupts = <0x00 0x83 0x01 0x00 0x84 0x01>;
	};

	vdec@17040000 {
		compatible = "mediatek,vdec";
		interrupts = <0x00 0xd7 0x08>;
		reg = <0x00 0x17040000 0x00 0x10000>;
	};

	vdec_gcon@17000000 {
		clock-names = "MT_CG_VDEC\0MT_CG_VENC\0MT_SCP_SYS_VDE\0MT_SCP_SYS_VEN";
		clocks = <0x37 0x03 0x37 0x01 0x1a 0x06 0x1a 0x06>;
		compatible = "mediatek,vdec_gcon";
		reg = <0x00 0x17000000 0x00 0x1000>;
	};

	venc@17020000 {
		compatible = "mediatek,venc";
		interrupts = <0x00 0xd4 0x08>;
		linux,phandle = <0x59>;
		phandle = <0x59>;
		reg = <0x00 0x17020000 0x00 0x1000>;
	};

	venc_global_con@17000000 {
		#clock-cells = <0x01>;
		compatible = "mediatek,venc_global_con\0syscon";
		linux,phandle = <0x37>;
		phandle = <0x37>;
		reg = <0x00 0x17000000 0x00 0x10000>;
	};

	venc_jpg@17030000 {
		clock-names = "MT_CG_VENC_JPGENC";
		clocks = <0x37 0x02>;
		compatible = "mediatek,venc_jpg";
		interrupts = <0x00 0xd6 0x08>;
		reg = <0x00 0x17030000 0x00 0x1000>;
	};

	wifi@180f0000 {
		clock-names = "wifi-dma";
		clocks = <0x19 0x28>;
		compatible = "mediatek,wifi";
		dma_addrmask = <0x24>;
		interrupts = <0x00 0xea 0x08>;
		reg = <0x00 0x180f0000 0x00 0x5c>;
	};
};
